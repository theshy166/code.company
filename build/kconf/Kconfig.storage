## build/kconf/Kconfig.storage
```kconfig
#storage size and type configure
#
menu "System Partition"

menu "System storage"

#### storage type

choice
    prompt "Storage type:"
    default STORAGE_TYPE_EMMC if CHIPSET_QM10XH
    default STORAGE_TYPE_SPINOR if CHIPSET_MC331X

config STORAGE_TYPE_SPINOR
    bool "spi nor"

config STORAGE_TYPE_SPINAND
    bool "spi nand"

config STORAGE_TYPE_EMMC
    bool "emmc"

# add more here
# TODO
#
endchoice


#### storage size
choice
    prompt "Storage size:"
    default STORAGE_SIZE_16G if STORAGE_TYPE_EMMC
    default STORAGE_SIZE_128MB if STORAGE_TYPE_SPINAND
    default STORAGE_SIZE_16MB if STORAGE_TYPE_SPINOR

config STORAGE_SIZE_4MB
    bool "4MB"
    depends on STORAGE_TYPE_SPINOR

config STORAGE_SIZE_8MB
    bool "8MB"
    depends on STORAGE_TYPE_SPINOR

config STORAGE_SIZE_16MB
    bool "16MB"
    depends on STORAGE_TYPE_SPINOR

config STORAGE_SIZE_32MB
    bool "32MB"
    depends on STORAGE_TYPE_SPINOR

config STORAGE_SIZE_128MB
    bool "128MB"
    depends on STORAGE_TYPE_SPINAND

config STORAGE_SIZE_256MB
    bool "256MB"
    depends on STORAGE_TYPE_SPINAND

config STORAGE_SIZE_512MB
    bool "512MB"
    depends on STORAGE_TYPE_SPINAND

config STORAGE_SIZE_1G
    bool "1G"
    depends on STORAGE_TYPE_EMMC || STORAGE_TYPE_SPINAND

config STORAGE_SIZE_8G
    bool "8G"
    depends on STORAGE_TYPE_EMMC

config STORAGE_SIZE_16G
    bool "16G"
    depends on STORAGE_TYPE_EMMC

config STORAGE_SIZE_64G
    bool "64G"
    depends on STORAGE_TYPE_EMMC

# add more here
# TODO
#
endchoice

endmenu

source "build/kconf/Kconfig.partition"
endmenu
```

## build/kconf/Kconfig.toolchain
```kconfig
menu "Toolchain"

choice
    prompt "Toolchain:"
    default TOOLCHAIN_ARM-LINUX-FHV512

    config TOOLCHAIN_ARC-FULLHAN-ELF32
        bool "arc-fullhan-elf32"
        help
          Configuration for arc-fullhan-elf32.

    config TOOLCHAIN_ARM-LINUX-FHV512
        bool "arm-linux-fhv512"
        help
          Configuration for arm-linux-fhv512.

    config TOOLCHAIN_ARM-LINUX-MOLCHIP
        bool "arm-linux-molchip"
        help
          Configuration for arm-linux-molchip.

    config TOOLCHAIN_ARM-LINUX-MOLV510
        bool "arm-linux-molv510"
        help
          Configuration for arm-linux-molv510.

    config TOOLCHAIN_ARM-LINUX-MUSLEABI
        bool "arm-linux-musleabi"
        help
          Configuration for arm-linux-musleabi.

    config TOOLCHAIN_SIMULATOR
        bool "simulator"
        help
          Configuration for simulator.

    config TOOLCHAIN_ARM-LINUX-MOLV2
        bool "arm-molv2-linux-uclibcgnueabi"
        help
          Configuration for arm-molv2-linux-uclibcgnueabi.

    config TOOLCHAIN_ARM-FULLHANV2-EABI
        bool "arm-fullhanv2-eabi"
        help
          Configuration for arm-fullhanv2-eabi.
    
     config TOOLCHAIN_ARM-LINUX-FHVA12C
        bool "arm-fhva12c-linux-uclibcgnueabihf"
        help
          Configuration for arm-fhva12c-linux-uclibcgnueabihf.

endchoice


endmenu
```

## build/kconf/Kconfig.uboot
```kconfig
menu "Uboot"

config UBOOT_DEFCONFIG
        string "defconfig file"
        default "quaming_qm108h_defconfig"
        help
          Enter the name of the xxx_xx_defconfig file, eg:
          quaming_qm108h_defconfig

config UBOOT_VERSION
        string "uboot version"
        default "v1.0"
        help
          Enter uboot version

config UBOOT_FEATURE_FB_MODE
    bool "system bootup fast mode"

config UBOOT_FEATURE_FASTBOOT_FLASH
    bool "fastboot flash feature"
    default y

config UBOOT_FEATURE_UDISK_FLASH
    bool "udisk flash feature"
    default y

#config UBOOT_FEATURE_BOOT_ANDROID
#    bool "bootandroid cmd in uboot"
#    default y if STORAGE_TYPE_EMMC
    #TODO
    #we gonna bringup bootandroid cmd for nand,nor etc.

#config UBOOT_FEATURE_VBMETA
#    bool "Configure vbmeta feature"
#    depends on UBOOT_FEATURE_BOOT_ANDROID

config QM_MAX_SPLIT_SIZE
    int "split sparse image to pices"
    default 268435456

config UBOOT_BOARD_NAME
    string "board name under uboot"
    default "NAME_NOT_DEFINED"
    help
          The option specifies the name of the target board
          for which uboot is being built. Its primary purpose is
          to ensure that the correct board-specific settings, drivers,
          configurations are applied during the build process or runtime

## add more features in uboot here
#TODO
endmenu
```

## build/kconf/Kconfig.utils
```kconfig
# For a description of the syntax of this configuration file,
# core/package/utils configuration.
#
menu "Utils Configure"

config XOS_UTILS_HELLO
	bool "Build Hello"
	default n
	depends on XOS_USE_NO_QUAUI
	help
		Select the xos utils hello sample.

endmenu
```

## product/common/Kconfig
```kconfig
#Common Configuration

menu "Common Feature configuration"

config XOS_USE_DEBUG
    bool "use debug"
    default y

## sample common configure
config COMMON_FEATURE1
    bool "Enable Feature 1"
    default y

config COMMON_FEATURE2
    bool "Enable Feature 2"

config COMMON_FEATURE3
    bool "Enable Feature 3"

config TEST_OPTION
	bool "Test Option"
	help
		Test option description

#TODO
# Include or add more configuration here
#source "xx/xxx/Kconfig"
endmenu
```

## product/esl/Kconfig
```kconfig
#Configuration

menu "Esl Features"

config XOS_PROJECT_TYPE
    string
    prompt "Project"
    default "esl"
    help
      Set the xos project.

config QM_VERSION
    string "software version"
    default "V1.00.00"

config LCD_PANEL
    bool "Display panel"
    default n

config TOUCH_PANEL
    bool "Touch Panel Feature"
    default n

config WIFI_SUPPORT
    bool "WiFi feature"
    default n

config XOS_WIFI_QUADRV
    string
    prompt "wifi_type"
    default "aic8800d"
    help
    Set wifi type.

config ETHERNET_SUPPORT
    bool "Ethernet feature"
    default n


# Include more configuration here
#source "xx/xxx/Kconfig"
endmenu
```

## product/esl2/Kconfig
```kconfig
#Configuration

menu "Esl Features"

config XOS_PROJECT_TYPE
    string
    prompt "Project"
    default "esl2"
    help
      Set the xos project.

config QM_VERSION
    string "software version"
    default "1.0.0"

config QM_HW_VERSION 
    string "hardware version"
    default "10"

config PLATFORM_ID
    string "flatform id"
    default "ESL10D"

config DISABLE_UPDATE
    bool "Disable Update"
    default n
    help
      Disable cloud update feature.

config LCD_PANEL
    bool "Display panel"
    default n

config TOUCH_PANEL
    bool "Touch Panel Feature"
    default n

config WIFI_SUPPORT
    bool "WiFi feature"
    default n

config XOS_WIFI_QUADRV
    string
    prompt "wifi_type"
    default "aic8800d"
    help
    Set wifi type.

config ETHERNET_SUPPORT
    bool "Ethernet feature"
    default n


# Include more configuration here
#source "xx/xxx/Kconfig"
endmenu
```

## product/esl2/project_esl2_skw_defconfig
```kconfig
CONFIG_XOS_PROJECT_TYPE="esl2"
CONFIG_PRODUCT_ESL2=y
CONFIG_QM_VERSION="2.0.3"
CONFIG_QM_HW_VERSION="20"
CONFIG_PLATFORM_ID="ESL20D"
# CONFIG_DISABLE_UPDATE=y
CONFIG_TOOLCHAIN_ARM-LINUX-MOLV2=y
CONFIG_CHIPSET_QM10XD=y
CONFIG_CHIPSET_QM102D=y
CONFIG_OS_LINUX=y
CONFIG_UBOOT_DEFCONFIG="quaming_qm10xd_esl_defconfig"
CONFIG_KERNEL_DEFCONFIG="quaming_qm10xd_esl_defconfig"
CONFIG_KERNEL_VERSION="linux-5.10.y"
CONFIG_KERNEL_DTB="quaming-kernel-qm10xd-esl.dtb"
CONFIG_ROOTFS_BUSYBOX_CONFIG="busybox_quaming_config"
CONFIG_ROOTFS_BUSYBOX_VERSION="1.36.1"

CONFIG_XOS_WIFI_QUADRV="ea6x21qx"

CONFIG_XOS_BUILD_SDK="qm10xd_linux"
CONFIG_XOS_BUILD_BOARD="qm10xd"
CONFIG_XOS_SDK_NAME="qm10xd_sdk"
CONFIG_XOS_SDK_PATH="base/soc/qm10xd/linux"

# CONFIG_STORAGE_TYPE_SPINOR is not set
CONFIG_STORAGE_TYPE_SPINAND=y
CONFIG_STORAGE_SIZE_128MB=y

CONFIG_QM_SYS_PARTI_NAME_LIST="uboot recovery boot logo system rootfs data"
CONFIG_QM_SYS_PARTI_INFOFILE="partition-info.txt"
CONFIG_QM_SYS_PARTI_DEFAULT_FS_TYPE="ext4"

CONFIG_XOS_FWK_APPMANAGER=y
# CONFIG_XOS_USE_APP_LAUNCHER is not set
CONFIG_XOS_USE_INNER_RES=y
CONFIG_XOS_FWK_PARAM=y
CONFIG_XOS_FWK_EFFECTS=y
CONFIG_XOS_FWK_GUIENG_LVGL9=y
CONFIG_XOS_USE_TINY_TTF=y
# CONFIG_XOS_INN_QUANTP is not set
CONFIG_XOS_FWK_PLAYER=y
CONFIG_XOS_EXT_FFMPEG=y
# CONFIG_XOS_FWK_FLOATWINDOW is not set
CONFIG_XOS_FWK_FONT=y
# CONFIG_XOS_FWK_MENU is not set
CONFIG_XOS_EXT_CJSON=y
CONFIG_XOS_EXT_ZLIB=y
CONFIG_XOS_FWK_UTILITY=y
CONFIG_XOS_FWK_QMCORE=y
CONFIG_XOS_HW_QUAMMAPI=y
CONFIG_XOS_USE_FB_DIRECT=y
# CONFIG_XOS_FB_ROTATION is not set
CONFIG_XOS_LCM_800x1280=y
CONFIG_XOS_RES_800x1280=y
CONFIG_XOS_LCM_2ND_SCR=y
CONFIG_XOS_EXT_CURL=y
CONFIG_XOS_FWK_CADP_CURL=y
# CONFIG_XOS_USE_APP_NATIVE_ESL is not set
CONFIG_XOS_APP_ESL2=y
CONFIG_XOS_FWK_CADP_DSN=y
CONFIG_XOS_FWK_LOGO=y

CONFIG_XOS_FWK_CADP_QUA=y
CONFIG_XOS_FWK_CADP=y
CONFIG_XOS_EXT_OPENSSL=y
CONFIG_XOS_EXT_LIBPNG=y
CONFIG_XOS_EXT_JPEG=y
CONFIG_XOS_USE_DEBUG=y
CONFIG_XOS_HW_QUADRV_EXT=y
CONFIG_XOS_LVGL_MEM_CNT=y

# CONFIG_XOS_EXT_SPNG is not set

CONFIG_XOS_USE_HW_JPEG=y
```
