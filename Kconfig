## X-AIOS-ESL/base/soc/qm10xd/linux/bsp/uboot/uboot/drivers/usb/phy/Kconfig
```kconfig
menuconfig USB_PHY
        bool "USB Physical Layer Drivers"
        ---help---
          Say Y here if you would like to enable support for USB Physical
	  Layer.

if USB_PHY

config MOLCHIP_USB2_PHY
        bool "Enable Molchip USB 2.0 PHY support"
        ---help---
          Say Y here if you would like to support Molchip USB 2.0
          Physical Layer Devices.
config MOLCHIP_USB3_PHY
        bool "Enable Molchip USB 3.0 PHY support"
        ---help---
          Say Y here if you would like to support Molchip USB 3.0
          Physical Layer Devices.	
endif
```

## base/soc/qm10xd/linux/bsp/kernel/linux-5.10.y/arch/arm/configs/molchip_xc01_C_defconfig
```kconfig
# CONFIG_LOCALVERSION_AUTO is not set
CONFIG_SYSVIPC=y
CONFIG_NO_HZ=y
CONFIG_PREEMPT_VOLUNTARY=y
CONFIG_BLK_DEV_INITRD=y
CONFIG_INITRAMFS_SOURCE="../../rootfs/initramfs-v510.cpio.gz"
CONFIG_ARCH_MOLCHIP=y
CONFIG_MACH_XC01=y
# CONFIG_VDSO is not set
# CONFIG_CACHE_L2X0 is not set
# CONFIG_DEBUG_ALIGN_RODATA is not set
CONFIG_SMP=y
CONFIG_HAVE_ARM_ARCH_TIMER=y
CONFIG_NR_CPUS=2
CONFIG_HIGHMEM=y
CONFIG_DEPRECATED_PARAM_STRUCT=y
CONFIG_NEON=y
CONFIG_KERNEL_MODE_NEON=y
CONFIG_CC_OPTIMIZE_FOR_SIZE=y
# CONFIG_STACKPROTECTOR is not set
CONFIG_MODULES=y
CONFIG_MODULE_UNLOAD=y
CONFIG_MODULE_FORCE_UNLOAD=y
CONFIG_PARTITION_ADVANCED=y
CONFIG_CMDLINE_PARTITION=y
CONFIG_NET=y
CONFIG_PACKET=y
CONFIG_PACKET_DIAG=y
CONFIG_UNIX=y
CONFIG_INET=y
CONFIG_IP_PNP=y
CONFIG_IP_PNP_DHCP=y
CONFIG_IP_PNP_BOOTP=y
CONFIG_IP_PNP_RARP=y
# CONFIG_IPV6 is not set
# CONFIG_WIRELESS is not set
CONFIG_PCI=y
CONFIG_DEVTMPFS=y
CONFIG_DEVTMPFS_MOUNT=y
CONFIG_MTD=y
CONFIG_MTD_BLOCK=y
CONFIG_MTD_BLOCK2MTD=y
CONFIG_MTD_RAW_NAND=y
CONFIG_MTD_SPI_NAND_MC=y
CONFIG_MTD_SPI_NAND=y
CONFIG_MTD_SPI_NOR=y
CONFIG_SPI_MC_SFC=y
CONFIG_EEPROM_AT24=y
CONFIG_MOLCHIP_PTS=y
CONFIG_BLK_DEV_SD=y
CONFIG_CHR_DEV_SG=y
CONFIG_ATA=y
CONFIG_SATA_AHCI_PLATFORM=y
CONFIG_NETDEVICES=y
CONFIG_SYNOPSYS_DWC_ETH_QOS=y
CONFIG_REALTEK_PHY=y
CONFIG_USB_USBNET=y
# CONFIG_WLAN is not set
CONFIG_INPUT_EVDEV=y
CONFIG_VT_HW_CONSOLE_BINDING=y
CONFIG_SERIAL_MOL_CONSOLE=y
CONFIG_HW_RANDOM=y
CONFIG_I2C_CHARDEV=y
CONFIG_I2C_DESIGNWARE_PLATFORM=y
CONFIG_I2C_DEBUG_CORE=y
CONFIG_I2C_DEBUG_ALGO=y
CONFIG_I2C_DEBUG_BUS=y
CONFIG_SPI=y
CONFIG_SPI_DESIGNWARE=y
CONFIG_SPI_DW_DMA=y
CONFIG_SPI_DW_MMIO=y
CONFIG_SPI_SPIDEV=y
CONFIG_GPIO_SYSFS=y
CONFIG_GPIO_MOLCHIP=y
# CONFIG_HWMON is not set
CONFIG_WATCHDOG=y
CONFIG_MOLCHIP_WATCHDOG=y
CONFIG_MEDIA_SUPPORT=y
CONFIG_MEDIA_CAMERA_SUPPORT=y
CONFIG_MEDIA_USB_SUPPORT=y
CONFIG_USB_VIDEO_CLASS=y
CONFIG_FB=y
CONFIG_USB=y
CONFIG_USB_ANNOUNCE_NEW_DEVICES=y
CONFIG_USB_XHCI_HCD=y
CONFIG_USB_ACM=y
CONFIG_USB_PRINTER=y
CONFIG_USB_STORAGE=y
CONFIG_USB_UAS=y
CONFIG_USB_DWC3=y
CONFIG_USB_SERIAL=y
CONFIG_USB_SERIAL_CONSOLE=y
CONFIG_USB_SERIAL_GENERIC=y
CONFIG_USB_GADGET=y
CONFIG_U_SERIAL_CONSOLE=y
CONFIG_USB_CONFIGFS=y
CONFIG_USB_CONFIGFS_SERIAL=y
CONFIG_USB_CONFIGFS_ACM=y
CONFIG_USB_CONFIGFS_MASS_STORAGE=y
CONFIG_USB_CONFIGFS_F_UVC=y
CONFIG_USB_MASS_STORAGE=m
CONFIG_USB_G_SERIAL=m
CONFIG_USB_G_WEBCAM=m
CONFIG_MMC=y
CONFIG_MMC_TEST=y
CONFIG_MMC_SDHCI=y
CONFIG_MMC_SDHCI_PLTFM=y
CONFIG_MMC_DW=y
CONFIG_MMC_SDHCI_MC=y
CONFIG_RTC_CLASS=y
CONFIG_RTC_DRV_MC=y
CONFIG_DMADEVICES=y
CONFIG_DMADEVICES_DEBUG=y
CONFIG_DMADEVICES_VDEBUG=y
CONFIG_MOLCHIP_DMA64=y
CONFIG_MOLCHIP_DMA64_IOCTL_DEMO=y
CONFIG_DMATEST=m
CONFIG_COMMON_CLK_MC_XC=y
CONFIG_HWSPINLOCK=y
CONFIG_HWSPINLOCK_MOLCHIP=y
# CONFIG_IOMMU_SUPPORT is not set
CONFIG_EXTCON=y
CONFIG_IIO=y
CONFIG_MOLCHIP_SARADC=y
CONFIG_PWM=y
CONFIG_PWM_MOLCHIP=y
CONFIG_RESET_CONTROLLER=y
CONFIG_MOLCHIP_USB2_PHY=y
CONFIG_MOLCHIP_USB3_PHY=y
CONFIG_MC_EFUSE=y
CONFIG_EFUSE_CTRL_NUM=0x2
CONFIG_MC_LOW_POWER=y
CONFIG_MC_SCENE_MANGT=y
CONFIG_EXT2_FS=y
# CONFIG_DNOTIFY is not set
CONFIG_VFAT_FS=y
CONFIG_FAT_DEFAULT_UTF8=y
CONFIG_TMPFS=y
CONFIG_JFFS2_FS=y
CONFIG_SQUASHFS=y
CONFIG_SQUASHFS_XZ=y
CONFIG_NFS_FS=y
CONFIG_NFS_V3_ACL=y
CONFIG_NLS_CODEPAGE_437=y
CONFIG_NLS_ISO8859_1=y
CONFIG_CRYPTO=y
CONFIG_CRYPTO_MANAGER=y
CONFIG_CRYPTO_USER_API_HASH=y
CONFIG_CRYPTO_USER_API_SKCIPHER=y
CONFIG_CRYPTO_USER_API_RNG=y
CONFIG_CRYPTO_USER_API_AEAD=y
CONFIG_CRYPTO_DEV_MC_AES=y
CONFIG_CRYPTO_DEV_MC_SHA=y
CONFIG_CRYPTO_DEV_CRYPTODEV=y
CONFIG_CRC16=y
CONFIG_PRINTK_TIME=y
CONFIG_PRINTK_DATE=y
CONFIG_FRAME_WARN=4096
CONFIG_MAGIC_SYSRQ=y
CONFIG_DEBUG_FS=y
CONFIG_DEBUG_KERNEL=y
CONFIG_RCU_CPU_STALL_TIMEOUT=210
# CONFIG_FTRACE is not set
```

## base/soc/qm10xd/linux/bsp/kernel/linux-5.10.y/arch/arm/configs/quaming_qm10xd_cb1_ld_defconfig
```kconfig
# CONFIG_LOCALVERSION_AUTO is not set
CONFIG_SWAP=y
CONFIG_SYSVIPC=y
CONFIG_POSIX_MQUEUE=y
CONFIG_NO_HZ=y
CONFIG_PREEMPT_VOLUNTARY=y
CONFIG_LOG_BUF_SHIFT=16
# CONFIG_BLK_DEV_INITRD is not set
#CONFIG_INITRAMFS_SOURCE="../../rootfs/initramfs-v510.cpio.xz"
#CONFIG_INITRAMFS_COMPRESSION_XZ=y
# CONFIG_RD_BZIP2 is not set
# CONFIG_RD_LZMA is not set
# CONFIG_RD_LZO is not set
# CONFIG_RD_LZ4 is not set
# CONFIG_RD_ZSTD is not set
CONFIG_CC_OPTIMIZE_FOR_SIZE=y
CONFIG_EXPERT=y
# CONFIG_SYSFS_SYSCALL is not set
# CONFIG_FHANDLE is not set
# CONFIG_BUG is not set
CONFIG_ELF_CORE=y
# CONFIG_IO_URING is not set
# CONFIG_VM_EVENT_COUNTERS is not set
# CONFIG_SLUB_DEBUG is not set
CONFIG_ARCH_MOLCHIP=y
CONFIG_MOLCHIP_FASTBOOT=y
CONFIG_ARCH_MOLCHIP_SUSPEND=y
# CONFIG_VDSO is not set
# CONFIG_CACHE_L2X0 is not set
CONFIG_HAVE_ARM_ARCH_TIMER=y
# CONFIG_ARM_MODULE_PLTS is not set
CONFIG_PM_DEBUG=y
# CONFIG_SECCOMP is not set
# CONFIG_STACKPROTECTOR is not set
# CONFIG_STRICT_KERNEL_RWX is not set
# CONFIG_STRICT_MODULE_RWX is not set
CONFIG_MODULES=y
CONFIG_MODULE_UNLOAD=y
# CONFIG_BLK_DEV_BSG is not set
CONFIG_PARTITION_ADVANCED=y
# CONFIG_EFI_PARTITION is not set
# CONFIG_MQ_IOSCHED_KYBER is not set
CONFIG_COMPACTION=y
CONFIG_NET=y
CONFIG_PACKET=y
CONFIG_UNIX=y
CONFIG_INET=y
CONFIG_IP_PNP=y
CONFIG_IP_PNP_DHCP=y
# CONFIG_IPV6 is not set
CONFIG_DNS_RESOLVER=y
# CONFIG_CAN is not set
# CONFIG_MOLCHIP_CAN is not set
CONFIG_UEVENT_HELPER=y
# CONFIG_FW_CACHE is not set
CONFIG_MTD=y
CONFIG_MTD_CMDLINE_PARTS=y
CONFIG_MTD_BLOCK=y
# CONFIG_MTD_RAW_NAND is not set
# CONFIG_MTD_SPI_NAND_MC is not set
# CONFIG_MTD_SPI_NAND is not set
CONFIG_MTD_SPI_NOR=y
CONFIG_SPI_MC_SFC=y
# CONFIG_MTD_UBI is not set
CONFIG_MOLCHIP_PTS=y
CONFIG_MOLCHIP_SYST=y
CONFIG_MOLCHIP_APB_TIMER=y
CONFIG_MOLCHIP_WAKEUP_SOURCE=y
CONFIG_SCSI=y
CONFIG_BLK_DEV_SD=y
# CONFIG_CHR_DEV_SG is not set
CONFIG_NETDEVICES=y
# CONFIG_NET_VENDOR_ALACRITECH is not set
# CONFIG_NET_VENDOR_AMAZON is not set
# CONFIG_NET_VENDOR_AQUANTIA is not set
# CONFIG_NET_VENDOR_ARC is not set
# CONFIG_NET_VENDOR_AURORA is not set
# CONFIG_NET_VENDOR_BROADCOM is not set
# CONFIG_NET_VENDOR_CADENCE is not set
# CONFIG_NET_VENDOR_CAVIUM is not set
# CONFIG_NET_VENDOR_CIRRUS is not set
# CONFIG_NET_VENDOR_CORTINA is not set
# CONFIG_NET_VENDOR_EZCHIP is not set
# CONFIG_NET_VENDOR_FARADAY is not set
# CONFIG_NET_VENDOR_GOOGLE is not set
# CONFIG_NET_VENDOR_HISILICON is not set
# CONFIG_NET_VENDOR_HUAWEI is not set
# CONFIG_NET_VENDOR_INTEL is not set
# CONFIG_NET_VENDOR_MARVELL is not set
# CONFIG_NET_VENDOR_MICREL is not set
# CONFIG_NET_VENDOR_MICROCHIP is not set
# CONFIG_NET_VENDOR_MICROSEMI is not set
# CONFIG_NET_VENDOR_NATSEMI is not set
# CONFIG_NET_VENDOR_NETRONOME is not set
# CONFIG_NET_VENDOR_NI is not set
# CONFIG_NET_VENDOR_PENSANDO is not set
# CONFIG_NET_VENDOR_QUALCOMM is not set
# CONFIG_NET_VENDOR_RENESAS is not set
# CONFIG_NET_VENDOR_ROCKER is not set
# CONFIG_NET_VENDOR_SAMSUNG is not set
# CONFIG_NET_VENDOR_SEEQ is not set
# CONFIG_NET_VENDOR_SOLARFLARE is not set
# CONFIG_NET_VENDOR_SMSC is not set
# CONFIG_NET_VENDOR_SOCIONEXT is not set
# CONFIG_NET_VENDOR_STMICRO is not set
CONFIG_SYNOPSYS_DWC_ETH_QOS=y
# CONFIG_NET_VENDOR_VIA is not set
# CONFIG_NET_VENDOR_WIZNET is not set
# CONFIG_NET_VENDOR_XILINX is not set
CONFIG_FH_PHY=y
# CONFIG_USB_USBNET is not set
# CONFIG_WLAN is not set
CONFIG_INPUT_EVDEV=y
# CONFIG_LEGACY_PTYS is not set
CONFIG_SERIAL_MOL_CONSOLE=y
# CONFIG_HW_RANDOM is not set
CONFIG_I2C=y
# CONFIG_I2C_COMPAT is not set
CONFIG_I2C_CHARDEV=y
# CONFIG_I2C_HELPER_AUTO is not set
CONFIG_I2C_DESIGNWARE_PLATFORM=y
CONFIG_SPI=y
CONFIG_SPI_DESIGNWARE=y
CONFIG_SPI_DW_DMA=y
CONFIG_SPI_DW_MMIO=y
CONFIG_SPI_SPIDEV=y
CONFIG_GPIO_SYSFS=y
CONFIG_GPIO_MOLCHIP=y
# CONFIG_HWMON is not set
CONFIG_WATCHDOG=y
CONFIG_MOLCHIP_WATCHDOG=y
CONFIG_MFD_MOLCHIP_MPU=y
# CONFIG_MEDIA_SUPPORT is not set
# CONFIG_MEDIA_USB_SUPPORT is not set
# CONFIG_USB_VIDEO_CLASS is not set
CONFIG_FB=y
CONFIG_USB=y
CONFIG_USB_ANNOUNCE_NEW_DEVICES=y
CONFIG_USB_DYNAMIC_MINORS=y
CONFIG_USB_XHCI_HCD=y
# CONFIG_USB_ACM is not set
# CONFIG_USB_PRINTER is not set
CONFIG_USB_STORAGE=y
CONFIG_USB_DWC2=y
# CONFIG_USB_GADGET is not set
# CONFIG_USB_CONFIGFS is not set
# CONFIG_USB_CONFIGFS_F_UVC is not set

CONFIG_MMC=y
CONFIG_MMC_SDHCI=y
CONFIG_MMC_SDHCI_PLTFM=y
CONFIG_MMC_DW=y
# CONFIG_MMC_SDHCI_MC is not set
CONFIG_RTC_CLASS=y
CONFIG_DMADEVICES=y
CONFIG_MOLCHIP_DMA64=y
CONFIG_MINI_CLK=y
# CONFIG_IOMMU_SUPPORT is not set
CONFIG_IIO=y
CONFIG_IIO_BUFFER=y
CONFIG_IIO_TRIGGER=y
CONFIG_IIO_ST_ACCEL_3AXIS=y
CONFIG_MOLCHIP_SARADC=y
CONFIG_PWM=y
CONFIG_PWM_MOLCHIP=y
CONFIG_RESET_CONTROLLER=y
CONFIG_MOLCHIP_USB2_PHY=y
CONFIG_MC_EFUSE=y
CONFIG_EFUSE_CTRL_NUM=0x1
CONFIG_MC_LOW_POWER=y
CONFIG_MC_SCENE_MANGT=y
CONFIG_VFAT_FS=y
CONFIG_TMPFS=y
CONFIG_JFFS2_FS=y
# CONFIG_UBIFS_FS is not set
# CONFIG_JFFS2_FS_WRITEBUFFER is not set
# CONFIG_CRAMFS is not set
CONFIG_SQUASHFS=y
CONFIG_SQUASHFS_ZSTD=y
CONFIG_SQUASHFS_DECOMP_MULTI=y
CONFIG_NFS_FS=y
# CONFIG_NFS_V2 is not set
CONFIG_NLS_CODEPAGE_437=y
CONFIG_NLS_ISO8859_1=y
CONFIG_NLS_UTF8=y
CONFIG_KEYS=y
CONFIG_CRYPTO=y
CONFIG_CRYPTO_MANAGER=y
CONFIG_CRYPTO_NULL=y
CONFIG_CRYPTO_USER_API_SKCIPHER=y
CONFIG_CRYPTO_ZSTD=y
# CONFIG_CRYPTO_USER_API_ENABLE_OBSOLETE is not set
CONFIG_CRYPTO_DEV_MC_AES=y
CONFIG_CRYPTO_DEV_CRYPTODEV=y
CONFIG_CRC16=y
CONFIG_PRINTK_TIME=y
CONFIG_PRINTK_DATE=y
# CONFIG_SYMBOLIC_ERRNAME is not set
CONFIG_FRAME_WARN=4096
CONFIG_MAGIC_SYSRQ=y
# CONFIG_DEBUG_MISC is not set
# CONFIG_SCHED_DEBUG is not set
CONFIG_TRACELOG=y
CONFIG_TRACELOG_USE_IRAM_MEM=y
CONFIG_RCU_CPU_STALL_TIMEOUT=210
# CONFIG_FTRACE is not set
CONFIG_OF=y

#wifi
CONFIG_MAC80211_RC_MINSTREL=y
#CONFIG_WLAN=y
#oth
CONFIG_WIRELESS=y
# CONFIG_WIRELESS_EXT is not set
# CONFIG_WEXT_CORE is not set
# CONFIG_WEXT_PROC is not set
# CONFIG_WEXT_PRIV is not set
CONFIG_CFG80211=y
# CONFIG_NL80211_TESTMODE is not set
# CONFIG_CFG80211_DEVELOPER_WARNINGS is not set
CONFIG_CFG80211_REQUIRE_SIGNED_REGDB=y
CONFIG_CFG80211_USE_KERNEL_REGDB_KEYS=y
CONFIG_CFG80211_DEFAULT_PS=y
# CONFIG_CFG80211_DEBUGFS is not set
CONFIG_CFG80211_CRDA_SUPPORT=y
# CONFIG_CFG80211_WEXT is not set
CONFIG_LIB80211=y
CONFIG_MAC80211=y
CONFIG_MAC80211_HAS_RC=y
#CONFIG_MAC80211_RC_MINSTREL=y
CONFIG_MAC80211_RC_DEFAULT_MINSTREL=y
CONFIG_MAC80211_RC_DEFAULT="minstrel_ht"
CONFIG_MAC80211_MESH=y
# CONFIG_MAC80211_DEBUGFS is not set
# CONFIG_MAC80211_MESSAGE_TRACING is not set
# CONFIG_MAC80211_DEBUG_MENU is not set
CONFIG_RFKILL=y
CONFIG_RFKILL_INPUT=y
CONFIG_RFKILL_GPIO=y
CONFIG_VIRT_WIFI=y

CONFIG_CRYPTO_AKCIPHER=y
CONFIG_CRYPTO_GF128MUL=y
CONFIG_CRYPTO_RSA=y
CONFIG_CRYPTO_CCM=y
CONFIG_CRYPTO_GCM=y
CONFIG_CRYPTO_CTR=y
CONFIG_CRYPTO_CMAC=y
CONFIG_CRYPTO_GHASH=y
CONFIG_ASYMMETRIC_KEY_TYPE=y
CONFIG_ASYMMETRIC_PUBLIC_KEY_SUBTYPE=y
CONFIG_X509_CERTIFICATE_PARSER=y
# CONFIG_USB_WDM is not set
CONFIG_STAGING=y
#seekwave
#CONFIG_WLAN_VENDOR_SEEKWAVE=y
#CONFIG_BT=y
#CONFIG_BT_RFCOMM=y
#CONFIG_BT_BNEP=y
#CONFIG_BT_CMTP=y
#CONFIG_BT_BREDR=y
#CONFIG_BT_RFCOMM_TTY=y
#CONFIG_BT_BNEP_MC_FILTER=y
#CONFIG_BT_BNEP_PROTO_FILTER=y
#CONFIG_BT_HIDP=y
# CONFIG_BT_HS is not set
#CONFIG_BT_LE=y
# CONFIG_BT_MSFTEXT is not set
#CONFIG_BT_DEBUGFS=y
# CONFIG_BT_SELFTEST is not set
# CONFIG_BT_FEATURE_DEBUG is not set

#
# Bluetooth device drivers
#
# CONFIG_BT_HCIBTUSB is not set
# CONFIG_BT_HCIBTSDIO is not set
#CONFIG_BT_HCIUART=y
#CONFIG_BT_HCIUART_H4=y
# CONFIG_BT_HCIUART_BCSP is not set
# CONFIG_BT_HCIUART_ATH3K is not set
# CONFIG_BT_HCIUART_INTEL is not set
# CONFIG_BT_HCIUART_AG6XX is not set
# CONFIG_BT_HCIBCM203X is not set
# CONFIG_BT_HCIBPA10X is not set
# CONFIG_BT_HCIBFUSB is not set
# CONFIG_BT_HCIVHCI is not set
# CONFIG_BT_MRVL is not set
# CONFIG_BT_MTKSDIO is not set
# end of Bluetooth device drivers

CONFIG_DEBUG_USER=y
CONFIG_DEBUG_FS=y
CONFIG_DEBUG_FS_ALLOW_ALL=y
CONFIG_BACKLIGHT_PWM=y
CONFIG_BACKLIGHT_CLASS_DEVICE=y
CONFIG_ZRAM=y
CONFIG_SYSFS=y
CONFIG_ZSMALLOC=y
CONFIG_ZRAM_NUM_DEVICES=1
# CONFIG_ZRAM_WRITEBACK is not set
CONFIG_INPUT_TOUCHSCREEN=y
CONFIG_TOUCHSCREEN_GSL1680=y
CONFIG_KEYBOARD_GPIO=y
CONFIG_MIGRATION=y
#CONFIG_MTD_SPI_NOR_USE_4K_SECTORS=n
CONFIG_MTD_SPI_NOR_USE_32K_SECTORS=y

CONFIG_ETHERNET=y
# CONFIG_MII is not set
# CONFIG_HAVE_PATA_PLATFORM is not set
# CONFIG_SERIO is not set
# CONFIG_HID is not set
# CONFIG_USB_HID is not set
# CONFIG_NETWORK_FILESYSTEMS is not set
CONFIG_SOUND=y
CONFIG_SND=y
CONFIG_SND_DRIVERS=y
CONFIG_SND_QUA=y
CONFIG_PROJ_XKPHOTO=y
CONFIG_NET_VENDOR_SYNOPSYS=y
CONFIG_POWER_RESET_GPIO=y
```
