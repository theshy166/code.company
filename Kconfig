## base/soc/qm10xd/linux/bsp/kernel/linux-5.10.y/arch/arm/mach-molchip/Kconfig
```kconfig
menuconfig ARCH_MOLCHIP
	bool "MOLCHIP Ltd. family"
	depends on ARCH_MULTI_V7
	select ARCH_SUPPORTS_BIG_ENDIAN
	select ARM_AMBA
	select ARM_GIC
	select ARM_GLOBAL_TIMER
	select ARM_TIMER_SP804
	select COMMON_CLK_MOLCHIP
	select GPIOLIB
	select HAVE_ARM_SCU if SMP
	select HAVE_ARM_TWD if SMP
	select HAVE_PATA_PLATFORM
	select NO_IOPORT_MAP
	select PLAT_MOLCHIP
	select POWER_RESET
	select POWER_SUPPLY
	select REGULATOR if MMC_ARMMMCI
	select REGULATOR_FIXED_VOLTAGE if REGULATOR
	select MFD_MOLCHIP_SYSREG
	select VFP
	select DW_APB_TIMER_OF
	select PINCTRL
	help
	  This option enables support for systems using Cortex processor based
	  ARM core and logic (FPGA) tiles on the MOLCHIP motherboard,
	  for example:

	  - TS01
	  - FY01

	  You must boot using a Flattened Device Tree in order to use these
	  platforms. The traditional (ATAGs) boot method is not usable on
	  these boards with this option.

if ARCH_MOLCHIP

config PLAT_MOLCHIP
	def_bool y
	help
	  Base platform code for any molchip device

config MACH_TS01
        bool "Molchip TS01 SoCs support"
        depends on ARCH_MOLCHIP

config MACH_FY01
        bool "Molchip FY01 SoCs support"
        depends on ARCH_MOLCHIP

config MACH_FY00
        bool "Molchip FY00 SoCs support"
        depends on ARCH_MOLCHIP

config MACH_FY02
        bool "Molchip FY02 SoCs support"
        depends on ARCH_MOLCHIP

config MACH_FY02P
        bool "Molchip FY02 SoCs support"
        depends on ARCH_MOLCHIP

config MACH_FY10P
        bool "Molchip FY02 SoCs support"
        depends on ARCH_MOLCHIP

config MACH_XC01
        bool "Molchip XC01 SoCs support"
        depends on ARCH_MOLCHIP

config ARCH_MOLCHIP_CORTEX_A5_A9_ERRATA
	bool "Enable A5 and A9 only errata work-arounds"
	default y
	select ARM_ERRATA_643719 if SMP
	select ARM_ERRATA_720789
	select PL310_ERRATA_753970 if CACHE_L2X0
	help
	  Provides common dependencies for Versatile Express platforms
	  based on Cortex-A5 and Cortex-A9 processors. In order to
	  build a working kernel, you must also enable relevant core
	  tile support or Flattened Device Tree based support options.

config ARCH_MOLCHIP_DCSCB
	bool "Dual Cluster System Control Block (DCSCB) support"
	depends on MCPM
	select ARM_CCI400_PORT_CTRL
	help
	  Support for the Dual Cluster System Configuration Block (DCSCB).
	  This is needed to provide CPU and cluster power management
	  on RTSM implementing big.LITTLE.

config ARCH_MOLCHIP_SPC
	bool "MOLCHIP Serial Power Controller (SPC)"
	select PM_OPP
	help
	  The TC2 (A15x2 A7x3) versatile express core tile integrates a logic
	  block called Serial Power Controller (SPC) that provides the interface
	  between the dual cluster test-chip and the M3 microcontroller that
	  carries out power management.

config ARCH_MOLCHIP_TC2_PM
	bool "Versatile Express TC2 power management"
	depends on MCPM
	select ARM_CCI400_PORT_CTRL
	select ARCH_MOLCHIP_SPC
	select ARM_CPU_SUSPEND
	help
	  Support for CPU and cluster power management on Versatile Express
	  with a TC2 (A15x2 A7x3) big.LITTLE core tile.

config ARCH_MOLCHIP_DEBUG
	bool "Enable molchip debug feature"
	default n
	help
	  Support molchip debug feature

config MOLCHIP_FASTBOOT
	bool "Enable molchip fastboot feature"
	default n
	help
	  Support molchip fastboot feature

config PROJ_XKPHOTO
	bool "project feature"
	default n
	help
	  Support xkphoto feature

config PROJ_ESL
	bool "project feature"
	default n
	help
	  Support esl feature

config ARCH_MOLCHIP_SUSPEND
	bool "Enable molchip suspend feature"
	default n
	help
	  Support molchip suspend feature
endif
```

## base/soc/qm10xd/linux/bsp/kernel/linux-5.10.y/drivers/crypto/cryptodev/Kconfig
```kconfig
config CRYPTO_DEV_CRYPTODEV
	tristate "CRYPTO CryptoDev Driver"
	help
	  Cryptodev linux is a device that allows access to Linux kernel cryptographic drivers;
	  Thus allowing of userspace applications to take advantage of hardware accelerators.
	  Cryptodev linux is implemented as a standalone module that requires no dependencies other than a stock linux kernel.
	  Its API is compatible with OpenBSD's cryptodev userspace API.
	  To compile this driver as a module, choose M here.
```

## base/soc/qm10xd/linux/bsp/kernel/linux-5.10.y/drivers/low-pwr/Kconfig
```kconfig
menu "low-pwr"
	config MC_LOW_POWER
	tristate "MC low-pwr support"

	source "drivers/low-pwr/scene-mangt/Kconfig"
endmenu
```

## base/soc/qm10xd/linux/bsp/kernel/linux-5.10.y/drivers/low-pwr/scene-mangt/Kconfig
```kconfig
config MC_SCENE_MANGT
	tristate "mc scene mangagement"
	depends on MC_LOW_POWER=y
```

## base/soc/qm10xd/linux/bsp/kernel/linux-5.10.y/drivers/misc/molchip/Kconfig
```kconfig
config MOLCHIP_PTS
	bool "Molchip PTS"
	help
	  molchip pts driver


config MOLCHIP_LZMA
	bool "Molchip LZMA"
	help
	  molchip lzma driver

config MOLCHIP_SYST
	bool "Molchip SYST"
	help
	  molchip sys timer driver

config MOLCHIP_APB_TIMER
	bool "Molchip APB Timer"
	help
	  molchip apb timer driver
config MOLCHIP_WAKEUP_SOURCE
	bool "Molchip wakeup source cfg"
	depends on ARCH_MOLCHIP_SUSPEND
	help
	  molchip wakeup source driver
```

## base/soc/qm10xd/linux/bsp/kernel/linux-5.10.y/drivers/net/ethernet/synopsys/Kconfig
```kconfig
# SPDX-License-Identifier: GPL-2.0-only
#
# Synopsys network device configuration
#

config NET_VENDOR_SYNOPSYS
	bool "Synopsys devices"
	default y
	help
	  If you have a network (Ethernet) device belonging to this class, say Y.

	  Note that the answer to this question doesn't directly affect the
	  kernel: saying N will just cause the configurator to skip all
	  the questions about Synopsys devices. If you say Y, you will be asked
	  for your specific device in the following questions.

if NET_VENDOR_SYNOPSYS

config SYNOPSYS_DWC_ETH_QOS
	tristate "Sypnopsys DWC Ethernet QOS v4.10a support"
	select PHYLIB
	select CRC32
	select MII
	depends on OF && HAS_DMA
	help
	  This driver supports the DWC Ethernet QoS from Synopsys

config DWC_XLGMAC
	tristate "Synopsys DWC Enterprise Ethernet (XLGMAC) driver support"
	depends on HAS_IOMEM && HAS_DMA
	select BITREVERSE
	select CRC32
	help
	  This driver supports the Synopsys DesignWare Cores Enterprise
	  Ethernet (dwc-xlgmac).

if DWC_XLGMAC

config DWC_XLGMAC_PCI
	tristate "XLGMAC PCI bus support"
	depends on DWC_XLGMAC && PCI
	help
	  This selects the pci bus support for the dwc-xlgmac driver.
	  This driver was tested on Synopsys XLGMAC IP Prototyping Kit.

	  If you have a controller with this interface, say Y or M here.
	  If unsure, say N.

endif # DWC_XLGMAC

endif # NET_VENDOR_SYNOPSYS
```

## base/soc/qm10xd/linux/bsp/uboot/uboot/arch/arm/mach-molchip/Kconfig
```kconfig
config MOLCHIP
	bool "MOLCHIP  SoC support"
	depends on ARCH_MOLCHIP
	select ARMV8_LPAE if ARM64
	select CPU_V7	if !ARM64

menu "MOLCHIP xxx family"
	depends on ARCH_MOLCHIP

choice
	prompt "MOLCHIP xxx board select"
	optional

config TARGET_MOLCHIP
	bool "molchip xxx evb"
	help
	  Support for all molchip-based  variants.

	  This option creates a build targetting the ARMv7/AArch32 ISA.
	select MOLCHIP

config TARGET_TS01
	bool "molchip ts01 evb"
        help
          Support for all molchip-based  variants.

          This option creates a build targetting the ARMv7/AArch32 ISA.
        select MOLCHIP


config TARGET_FY01
	bool "molchip fy01 evb"
        help
          Support for all molchip-based  variants.

          This option creates a build targetting the ARMv7/AArch32 ISA.
        select MOLCHIP

config TARGET_FY00
	bool "molchip fy00 evb"
        help
          Support for all molchip-based  variants.

          This option creates a build targetting the ARMv7/AArch32 ISA.
        select MOLCHIP

config TARGET_FY10D
	bool "molchip fy10d evb"
        help
          Support for all molchip-based  variants.

          This option creates a build targetting the ARMv7/AArch32 ISA.
        select MOLCHIP

config TARGET_FY10DS
	bool "molchip fy10ds evb"
        help
          Support for all molchip-based  variants.

          This option creates a build targetting the ARMv7/AArch32 ISA.
        select MOLCHIP

config TARGET_FY02
	bool "molchip fy02 evb"
        help
          Support for all molchip-based  variants.

          This option creates a build targetting the ARMv7/AArch32 ISA.
        select MOLCHIP

config TARGET_FY02B
	bool "molchip fy02b evb"
        help
          Support for all molchip-based  variants.

          This option creates a build targetting the ARMv7/AArch32 ISA.
        select MOLCHIP

config TARGET_FY02P
	bool "molchip fy02p evb"
        help
          Support for all molchip-based  variants.

          This option creates a build targetting the ARMv7/AArch32 ISA.
        select MOLCHIP

config TARGET_FY10P
	bool "molchip fy10p evb"
        help
          Support for all molchip-based  variants.

          This option creates a build targetting the ARMv7/AArch32 ISA.
        select MOLCHIP

config TARGET_XC01
        bool "molchip xc01 evb"
        help
          Support for all molchip-based  variants.

          This option creates a build targetting the ARMv7/AArch32 ISA.
        select MOLCHIP

config TARGET_LT00
        bool "molchip lt00 evb"
        help
          Support for all molchip-based  variants.

          This option creates a build targetting the ARMv7/AArch32 ISA.
        select MOLCHIP

config TARGET_MC3302
        bool "molchip mc3302 evb"
        help
          Support for all molchip-based  variants.

          This option creates a build targetting the ARMv7/AArch32 ISA.
        select MOLCHIP

endchoice

config SYS_SOC
	default "molchip"

endmenu

menu "MOLCHIP ARM64 FAMILY"
        depends on ARCH_MOLCHIP

choice
        prompt "MOLCHIP ARM64 board select"
        optional

config TARGET_FY12
        bool "molchip fy12 evb"
        help
          Support for all molchip-based  variants.
          This option creates a build targetting the ARMv8/AArch64 ISA.
	select MOLCHIP
endchoice

config SYS_SOC
        default "molchip"

config UBOOT_WIFIX
        bool "QM10XD WIFIX"
        help
          Support for WIFIX  variants.

config UBOOT_XKPHOTO
        bool "QM10XD XKPHOTO"
        help
          Support for XKPHOTO variants.


config UBOOT_ESL
        bool "QM10XD ESL"
        help
          Support for ESL variants.


config UBOOT_SMARTDOOR
        bool "QM10XD SMARTDOOR"
        help
          Support for SMARTDOOR variants.

config UBOOT_CB1LD
        bool "QM10XD Core board v1"
        help
          Support for core board variants.
endmenu
```

## base/soc/qm10xd/linux/bsp/uboot/uboot/board/molchip/Kconfig
```kconfig
config SYS_BOARD
	default "molchip"
config SYS_CONFIG_NAME
	string "molchip project,such as fyxx"

config SPL_MMC_SUPPORT
	bool "emmc support"
	default n

config SELECT_LOAD_UBOOT
	bool "Boot mode"
	default y
	help
	  Select this option to boot image
	  This option is enabled by default for U-Boot.

config PRG_BOOT_STAGE_PLUSIN
	bool "Pre-rolling boot stage"
	default y
	help
	  This option is enabled to boot pre-rolling.

config RTT_BOOT_STAGE_PLUSIN
	bool "RT-thread boot stage"
	default y
	help
	  This option is enabled to boot rtt.

config BOOT_STAGE_LOAD_NN
	bool "LOAD NN MODEL"
	default y
	help
	  This option is enabled to load nnmodel.

config ADAPTIVE_MEMORY_SUPPORT
	bool "Enable adtaptive-memory"
	default y
	help
	  Adaptive-memory detection mechanism on here.

config SPL_ARGS_TRSF
        bool "SPL Support ARGS Transmit"
        help
          This macro is used to turn on the SPL parameter passing function.

config SPL_ARGS_STR
        string "SPL Parameter to be passed"
        default "earlycon console=ttyS0,115200 bbbbbbbbbbbbbbbbb111111111111111"
        depends on SPL_ARGS_TRSF
        help
          Implement this macro to pass your parameters.

config BOOT_RAM_SIZE
        hex "Custom boot ram size"
        help
          Implement this macro to configure boot ram size

config SUPPORT_USB2
        bool "Support USB2"
        default y
        help
          This option is enabled to support USB2.

config  NOR_UPDATE
	bool "Support for NOR flash"
	help
           The SoC supports having a NOR flash connected

config  NAND_UPDATE
	bool "Support for NAND flash"
	help
           The SoC supports having a NAND flash connected
```

## base/soc/qm10xd/linux/bsp/uboot/uboot/common/pdl/Kconfig
```kconfig
menu "PDL"

config PDL
	bool
	prompt "Enable PDL"
	help
	  If you want to build PDL as well as the normal image, say Y.

if PDL

config PDL_LDSCRIPT
	string "Linker script for the PDL stage"
	default "arch/$(ARCH)/cpu/u-boot-pdl.lds"
	depends on PDL
	help
	  The PDL stage will usually require a different linker-script
	  (as it runs from a different memory region) than the regular
	  U-Boot stage.	 Set this to the path of the linker-script to
	  be used for PDL.


config PDL_TEXT_BASE
       	hex "Base address for the .text section of the PDL stage"
	help
	  The base address for the .text section of the PDL stage.

config PDL_STACK
        hex "Base address for PDL sp"

endif # PDL
endmenu
```

## base/soc/qm10xd/linux/bsp/uboot/uboot/common/quaming/logo/Kconfig
```kconfig
config QUA_LOGO
	bool "qua logo"
	default n
	help
	  This enables qua logo.

config QUA_LOGO_MIPI_JD9365D
	bool "qua logo mipi jd9365d 800x1280"
	depends on QUA_LOGO
	default n if QUA_LOGO
	help
	  This enables qua logo mipi jd9365d 800x1280.

config QUA_LOGO_MIPI_JD9365D_FLIP_H_V
	bool "qua logo mipi jd9365d filp horizontal & Vertical"
	depends on QUA_LOGO
	default n if QUA_LOGO
	help
	  This enables qua logo mipi jd9365d  filp horizontal & Vertical.

config QUA_LOGO_MIPI_JD9365D_PWR_CTRL
	bool "qua logo mipi jd9365d power on timing ctrl"
	depends on QUA_LOGO
	default n if QUA_LOGO
	help
	  This enables qua logo mipi jd9365d power on timing ctrl.

config QUA_LOGO_RGB_EK79001H
	bool "qua logo rgb ek79001h 1024x600"
	depends on QUA_LOGO
	default n if QUA_LOGO
	help
	  This enables qua logo rgb ek79001h 1024x600.

config QUA_LCM_2ND_SCR
	bool "qua logo dual lcm screen"
	depends on QUA_LOGO
	default n if QUA_LOGO
	help
	  This enables qua logo dual lcm screen.

config QUA_LOGO_PART
	bool "qua logo partition"
	depends on QUA_LOGO
	default n if QUA_LOGO
	help
	  This enables qua logo read from logo partition.
```
