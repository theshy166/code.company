## X-AIOS-ESL/base/soc/qm10xd/linux/bsp/kernel/linux-5.10.y/arch/arm/configs/molchip_lt00_defconfig
```kconfig
# CONFIG_LOCALVERSION_AUTO is not set
# CONFIG_SWAP is not set
CONFIG_SYSVIPC=y
CONFIG_POSIX_MQUEUE=y
CONFIG_NO_HZ=y
CONFIG_PREEMPT_VOLUNTARY=y
CONFIG_LOG_BUF_SHIFT=16
CONFIG_BLK_DEV_INITRD=y
CONFIG_INITRAMFS_SOURCE="../../rootfs/initramfs-v510.cpio.gz"
# CONFIG_RD_BZIP2 is not set
# CONFIG_RD_LZMA is not set
# CONFIG_RD_LZO is not set
# CONFIG_RD_LZ4 is not set
# CONFIG_RD_ZSTD is not set
CONFIG_CC_OPTIMIZE_FOR_SIZE=y
CONFIG_EXPERT=y
# CONFIG_SYSFS_SYSCALL is not set
# CONFIG_FHANDLE is not set
# CONFIG_BUG is not set
# CONFIG_ELF_CORE is not set
# CONFIG_IO_URING is not set
# CONFIG_VM_EVENT_COUNTERS is not set
# CONFIG_SLUB_DEBUG is not set
CONFIG_ARCH_MOLCHIP=y
CONFIG_MOLCHIP_FASTBOOT=y
CONFIG_ARCH_MOLCHIP_SUSPEND=y
# CONFIG_VDSO is not set
# CONFIG_CACHE_L2X0 is not set
CONFIG_HAVE_ARM_ARCH_TIMER=y
# CONFIG_ARM_MODULE_PLTS is not set
CONFIG_PM_DEBUG=y
# CONFIG_SECCOMP is not set
# CONFIG_STACKPROTECTOR is not set
# CONFIG_STRICT_KERNEL_RWX is not set
# CONFIG_STRICT_MODULE_RWX is not set
CONFIG_MODULES=y
CONFIG_MODULE_UNLOAD=y
# CONFIG_BLK_DEV_BSG is not set
CONFIG_PARTITION_ADVANCED=y
# CONFIG_EFI_PARTITION is not set
# CONFIG_MQ_IOSCHED_KYBER is not set
# CONFIG_COMPACTION is not set
CONFIG_NET=y
CONFIG_PACKET=y
CONFIG_UNIX=y
CONFIG_INET=y
CONFIG_IP_PNP=y
CONFIG_IP_PNP_DHCP=y
# CONFIG_IPV6 is not set
CONFIG_DNS_RESOLVER=y
CONFIG_CAN=y
CONFIG_MOLCHIP_CAN=y
# CONFIG_WIRELESS is not set
CONFIG_UEVENT_HELPER=y
# CONFIG_FW_CACHE is not set
CONFIG_MTD=y
CONFIG_MTD_CMDLINE_PARTS=y
CONFIG_MTD_BLOCK=y
CONFIG_MTD_RAW_NAND=y
CONFIG_MTD_SPI_NAND_MC=y
CONFIG_MTD_SPI_NAND=y
CONFIG_MTD_SPI_NOR=y
CONFIG_SPI_MC_SFC=y
CONFIG_MOLCHIP_PTS=y
CONFIG_MOLCHIP_SYST=y
CONFIG_MOLCHIP_APB_TIMER=y
CONFIG_MOLCHIP_WAKEUP_SOURCE=y
CONFIG_SCSI=y
CONFIG_BLK_DEV_SD=y
CONFIG_CHR_DEV_SG=y
CONFIG_NETDEVICES=y
# CONFIG_NET_VENDOR_ALACRITECH is not set
# CONFIG_NET_VENDOR_AMAZON is not set
# CONFIG_NET_VENDOR_AQUANTIA is not set
# CONFIG_NET_VENDOR_ARC is not set
# CONFIG_NET_VENDOR_AURORA is not set
# CONFIG_NET_VENDOR_BROADCOM is not set
# CONFIG_NET_VENDOR_CADENCE is not set
# CONFIG_NET_VENDOR_CAVIUM is not set
# CONFIG_NET_VENDOR_CIRRUS is not set
# CONFIG_NET_VENDOR_CORTINA is not set
# CONFIG_NET_VENDOR_EZCHIP is not set
# CONFIG_NET_VENDOR_FARADAY is not set
# CONFIG_NET_VENDOR_GOOGLE is not set
# CONFIG_NET_VENDOR_HISILICON is not set
# CONFIG_NET_VENDOR_HUAWEI is not set
# CONFIG_NET_VENDOR_INTEL is not set
# CONFIG_NET_VENDOR_MARVELL is not set
# CONFIG_NET_VENDOR_MICREL is not set
# CONFIG_NET_VENDOR_MICROCHIP is not set
# CONFIG_NET_VENDOR_MICROSEMI is not set
# CONFIG_NET_VENDOR_NATSEMI is not set
# CONFIG_NET_VENDOR_NETRONOME is not set
# CONFIG_NET_VENDOR_NI is not set
# CONFIG_NET_VENDOR_PENSANDO is not set
# CONFIG_NET_VENDOR_QUALCOMM is not set
# CONFIG_NET_VENDOR_RENESAS is not set
# CONFIG_NET_VENDOR_ROCKER is not set
# CONFIG_NET_VENDOR_SAMSUNG is not set
# CONFIG_NET_VENDOR_SEEQ is not set
# CONFIG_NET_VENDOR_SOLARFLARE is not set
# CONFIG_NET_VENDOR_SMSC is not set
# CONFIG_NET_VENDOR_SOCIONEXT is not set
# CONFIG_NET_VENDOR_STMICRO is not set
CONFIG_SYNOPSYS_DWC_ETH_QOS=y
# CONFIG_NET_VENDOR_VIA is not set
# CONFIG_NET_VENDOR_WIZNET is not set
# CONFIG_NET_VENDOR_XILINX is not set
CONFIG_FH_PHY=y
CONFIG_USB_USBNET=y
# CONFIG_WLAN is not set
CONFIG_INPUT_EVDEV=y
# CONFIG_LEGACY_PTYS is not set
CONFIG_SERIAL_MOL_CONSOLE=y
# CONFIG_HW_RANDOM is not set
CONFIG_I2C=y
# CONFIG_I2C_COMPAT is not set
CONFIG_I2C_CHARDEV=y
# CONFIG_I2C_HELPER_AUTO is not set
CONFIG_I2C_DESIGNWARE_PLATFORM=y
CONFIG_SPI=y
CONFIG_SPI_DESIGNWARE=y
CONFIG_SPI_DW_DMA=y
CONFIG_SPI_DW_MMIO=y
CONFIG_SPI_SPIDEV=y
CONFIG_GPIO_SYSFS=y
CONFIG_GPIO_MOLCHIP=y
# CONFIG_HWMON is not set
CONFIG_WATCHDOG=y
CONFIG_MOLCHIP_WATCHDOG=y
CONFIG_MFD_MOLCHIP_MPU=y
CONFIG_MEDIA_SUPPORT=y
CONFIG_MEDIA_USB_SUPPORT=y
CONFIG_USB_VIDEO_CLASS=y
CONFIG_FB=y
CONFIG_USB=y
CONFIG_USB_ANNOUNCE_NEW_DEVICES=y
CONFIG_USB_DYNAMIC_MINORS=y
CONFIG_USB_XHCI_HCD=y
CONFIG_USB_ACM=y
CONFIG_USB_PRINTER=y
CONFIG_USB_STORAGE=y
CONFIG_USB_DWC2=y
CONFIG_USB_GADGET=y
CONFIG_USB_CONFIGFS=y
CONFIG_USB_CONFIGFS_F_UVC=y

CONFIG_MMC=y
CONFIG_MMC_SDHCI=y
CONFIG_MMC_SDHCI_PLTFM=y
CONFIG_MMC_DW=y
# CONFIG_MMC_SDHCI_MC is not set
CONFIG_RTC_CLASS=y
CONFIG_DMADEVICES=y
CONFIG_MOLCHIP_DMA64=y
CONFIG_MINI_CLK=y
# CONFIG_IOMMU_SUPPORT is not set
CONFIG_IIO=y
CONFIG_MOLCHIP_SARADC=y
CONFIG_PWM=y
CONFIG_PWM_MOLCHIP=y
CONFIG_RESET_CONTROLLER=y
CONFIG_MOLCHIP_USB2_PHY=y
CONFIG_MC_EFUSE=y
CONFIG_EFUSE_CTRL_NUM=0x1
CONFIG_MC_LOW_POWER=y
CONFIG_MC_SCENE_MANGT=y
CONFIG_VFAT_FS=y
CONFIG_TMPFS=y
CONFIG_JFFS2_FS=y
# CONFIG_JFFS2_FS_WRITEBUFFER is not set
CONFIG_NFS_FS=y
# CONFIG_NFS_V2 is not set
CONFIG_NLS_CODEPAGE_437=y
CONFIG_NLS_ISO8859_1=y
CONFIG_NLS_UTF8=y
CONFIG_KEYS=y
CONFIG_CRYPTO=y
CONFIG_CRYPTO_MANAGER=y
CONFIG_CRYPTO_NULL=y
CONFIG_CRYPTO_USER_API_SKCIPHER=y
# CONFIG_CRYPTO_USER_API_ENABLE_OBSOLETE is not set
CONFIG_CRYPTO_DEV_MC_AES=y
CONFIG_CRYPTO_DEV_CRYPTODEV=y
CONFIG_CRC16=y
CONFIG_PRINTK_TIME=y
CONFIG_PRINTK_DATE=y
# CONFIG_SYMBOLIC_ERRNAME is not set
CONFIG_FRAME_WARN=4096
CONFIG_MAGIC_SYSRQ=y
# CONFIG_DEBUG_MISC is not set
# CONFIG_SCHED_DEBUG is not set
CONFIG_TRACELOG=y
CONFIG_TRACELOG_USE_IRAM_MEM=y
CONFIG_RCU_CPU_STALL_TIMEOUT=210
# CONFIG_FTRACE is not set
CONFIG_DEBUG_USER=y
```

## X-AIOS-ESL/base/soc/qm10xd/linux/bsp/kernel/linux-5.10.y/arch/arm64/mach-molchip/Kconfig
```kconfig
menuconfig ARCH_MOLCHIP
	bool "MOLCHIP Ltd. family"
	depends on ARM64

if ARCH_MOLCHIP
config NO_CACHE_COHERENCE
	bool "cpu sys bus not support cache coherence"
	depends on ARCH_MOLCHIP
endif #if ARCH_MOLCHIP
menuconfig DDR_PERFMON
	bool "MOLCHIP DDR PERFMONITOR"
	depends on ARM64
```

## X-AIOS-ESL/base/soc/qm10xd/linux/bsp/kernel/linux-5.10.y/drivers/clk/molchip/Kconfig
```kconfig
config COMMON_CLK_MC_TS01
	tristate "MOLCHIP TS01 Clock Driver"
	depends on ARCH_MOLCHIP || COMPILE_TEST
	select REGMAP_MMIO
	help
	  Support for the global clock controller on MOLCHIP devices.
	  Say Y if you want to use devices such as UART, SPI i2c, USB,
	  display, graphics, camera etc.
config COMMON_CLK_MC_FY01
	tristate "MOLCHIP FY01 Clock Driver"
	depends on ARCH_MOLCHIP || COMPILE_TEST
	select REGMAP_MMIO
	help
	  Support for the global clock controller on MOLCHIP devices.
	  Say Y if you want to use devices such as UART, SPI i2c, USB,
	  display, graphics, camera etc.

config COMMON_CLK_MC_FY00
	tristate "MOLCHIP FY00 Clock Driver"
	depends on ARCH_MOLCHIP || COMPILE_TEST
	select REGMAP_MMIO
	help
	  Support for the global clock controller on MOLCHIP devices.
	  Say Y if you want to use devices such as UART, SPI i2c, USB,
	  display, graphics, camera etc.

config COMMON_CLK_MC_FY12
	tristate "MOLCHIP FY12 Clock Driver"
	depends on ARCH_MOLCHIP || COMPILE_TEST
	select REGMAP_MMIO
	help
	  Support for the global clock controller on MOLCHIP devices.
	  Say Y if you want to use devices such as UART, SPI i2c, USB,
	  display, graphics, camera etc.
config COMMON_CLK_MC_FY13
	tristate "MOLCHIP FY13 Clock Driver"
	depends on ARCH_MOLCHIP || COMPILE_TEST
	select REGMAP_MMIO
	help
	  Support for the global clock controller on MOLCHIP devices.
	  Say Y if you want to use devices such as UART, SPI i2c, USB,
	  display, graphics, camera etc.

config COMMON_CLK_MC_FY03
        tristate "MOLCHIP FY03 Clock Driver"
        depends on ARCH_MOLCHIP || COMPILE_TEST
        select REGMAP_MMIO
        help
          Support for the global clock controller on MOLCHIP devices.
          Say Y if you want to use devices such as UART, SPI i2c, USB,
          display, graphics, camera etc.

config COMMON_CLK_MC_XC
        tristate "MOLCHIP XC Clock Driver"
        depends on ARCH_MOLCHIP || COMPILE_TEST
        select REGMAP_MMIO
        help
          Support for the global clock controller on MOLCHIP devices.
          Say Y if you want to use devices such as UART, SPI i2c, USB,
          display, graphics, camera etc.

config MINI_CLK
        tristate "MOLCHIP Mini Clock Driver"
        depends on ARCH_MOLCHIP || COMPILE_TEST
        select REGMAP_MMIO
        help
          Support for the global clock controller on MOLCHIP devices.
          Say Y if you want to use devices such as UART, SPI i2c, USB,
          display, graphics, camera etc.
```

## X-AIOS-ESL/base/soc/qm10xd/linux/bsp/kernel/linux-5.10.y/drivers/dma/molchip/Kconfig
```kconfig
#
# DMA engine configuration for molchip
#
config MOLCHIP_DMA64
	tristate "molchip DMA64 driver support"
	select DMA_ENGINE_RAID
	help
	  Support the molchip  DMA64 controlle.
config MOLCHIP_DMA64_IOCTL_DEMO
	bool "DMA64 IOCTL DEMO"
	depends on MOLCHIP_DMA64
	help
	  This a test program, just for test lowerlever dmaengine interface.
```

## X-AIOS-ESL/base/soc/qm10xd/linux/bsp/kernel/linux-5.10.y/drivers/pinctrl/molchip/Kconfig
```kconfig
if ARCH_MOLCHIP || COMPILE_TEST

config PINCTRL_MC
	bool
	depends on OF
	select PINMUX
	select GENERIC_PINCONF
	select GPIOLIB
	select OF_GPIO

# For ARMv7 SoCs

config PINCTRL_MOLCHIP
	bool "MOCHIP pin control"
	depends on OF
	default ARCH_MOLCHIP
	select PINCTRL_MC

endif
```

## X-AIOS-ESL/base/soc/qm10xd/linux/bsp/uboot/uboot/common/quaming/Kconfig
```kconfig
menu "FLASH FEATURE"

config FLASH_FW_ON_KEY_PRESS
	bool "Flash device on key press"
	default n
	help
		Flash device when the specified key is pressed.

config LED_INDICATOR_FOR_FLASH
	bool "Enable LED indicator during flash operations"
	default n
	help
		This option enables an LED indicator during flash operations (e.g., firmware
		updates). The LED will blink or change state to indicate the progress or status
		of the flash process.

		If enabled, ensure that the correct GPIO is configured for the LED in the
		board-specific configuration file.

config LED_INDICATOR_GPIO
	int "GPIO number for LED indicator during flash operations"
	depends on LED_INDICATOR_FOR_FLASH
	help
		This option specifies the GPIO number used for the LED indicator during
		flash operations. The LED will blink or change state to indicate the
		progress or status of the flash process.

		Ensure that the specified GPIO is available and properly configured
		on your hardware.

config WRITE_MACID
	bool "Enable MAC ID writing support"
	default n
	help
		This option enables support for writing MAC addresses (MAC ID) to a
		storage location (e.g., EEPROM or Flash) during device initialization.

config WRITE_SN
        bool "Enable SN writing support"
        default n
        help
                This option enables support for writing SN to a
                storage location (e.g., EEPROM or Flash) during device initialization.
endmenu

menu "Start-up hooks"

config INIT_PINDRIVING
    bool "Initialize pin driving strength"
    default n
    help
      Initialize pin driving strength settings early in boot process.
      This is needed for boards that require specific drive strength
      configurations for proper operation.

config INIT_GPIOS
    bool "Initialize GPIOs"
    default n
    help
      Initialize GPIO pins early in the boot process.
      This includes setting up default states for critical GPIOs
      before main peripherals are initialized.

endmenu
source "common/quaming/logo/Kconfig"
```

## X-AIOS-ESL/base/soc/qm10xd/linux/bsp/uboot/uboot/common/sdl/Kconfig
```kconfig
menu "SDL"


config SUPPORT_SDL
        bool

config SDL
        bool
        depends on SUPPORT_SDL
        prompt "Enable SDL"
        help
          If you want to build SDL as well as the normal image, say Y.
if SDL

config SDL_LDSCRIPT
	string "Linker script for the PDL stage"
	default "arch/$(ARCH)/cpu/u-boot-sdl.lds"
	depends on SDL
	help
	  The SDL stage will usually require a different linker-script
	  (as it runs from a different memory region) than the regular
	  U-Boot stage.	 Set this to the path of the linker-script to
	  be used for SDL.


config SDL_TEXT_BASE
        hex "Base address for the .text section of the SDL stage"
	help
	  The base address for the .text section of the SDL stage.

config SDL_STACK
        hex "Base address for SDL sp"

config SDL_NAND_SUPPORT
        bool "Support NAND flash"
        help
          Enable support for NAND (Negative AND) flash in SDL. 
          This enables the drivers in drivers/mtd/nand as part of an SDL
          build.

config SDL_SPI_FLASH_SUPPORT	
	bool "Support NOR flash"
        help
          Enable support for Nor NAND (Negative AND) flash in SDL.
          This enables the drivers in drivers/mtd/spi as part of an SDL
          build.

config SDL_MMC_SUPPORT
	bool "Support MMC."
	help
	  Enable support fot mmc/sdio/sdcard in SDL.


endif # SDL
endmenu
```

## X-AIOS-ESL/base/soc/qm10xd/linux/bsp/uboot/uboot/configs/molchip_defconfig
```kconfig
CONFIG_ARM=y
CONFIG_ARCH_MOLCHIP=y
CONFIG_TARGET_MOLCHIP=y
#CONFIG_DISTRO_DEFAULTS=y
# CONFIG_DISPLAY_CPUINFO is not set
# CONFIG_DISPLAY_BOARDINFO is not set
# CONFIG_CMD_CONSOLE is not set
# CONFIG_CMD_BOOTD is not set
# CONFIG_CMD_BOOTEFI is not set
# CONFIG_CMD_IMLS is not set
# CONFIG_CMD_XIMG is not set
# CONFIG_CMD_EDITENV is not set
# CONFIG_CMD_ENV_EXISTS is not set
# CONFIG_CMD_FLASH is not set
# CONFIG_CMD_FPGA is not set
# CONFIG_CMD_LOADB is not set
# CONFIG_CMD_LOADS is not set
CONFIG_ENV_IS_NOWHERE=y
# CONFIG_CMD_ITEST is not set
# CONFIG_CMD_SETEXPR is not set
# CONFIG_CMD_NFS is not set
# CONFIG_CMD_MISC is not set
# CONFIG_CMD_NET is not set
CONFIG_BAUDRATE=115200
CONFIG_OF_LIBFDT=y
CONFIG_CMD_BOOTZ=y
CONFIG_SYS_PROMPT="uboot#"
# CONFIG_EFI_LOADER is not set
# CONFIG_NET is not set
# CONFIG_PARTITIONS is not set
CONFIG_BOOTDELAY=0
```

## X-AIOS-ESL/base/soc/qm10xd/linux/bsp/uboot/uboot/configs/molchip_fy01_defconfig
```kconfig
CONFIG_ARM=y
CONFIG_SYS_CONFIG_NAME="fy01"
CONFIG_ARCH_MOLCHIP=y
CONFIG_SYS_MALLOC_F_LEN=0x8000
CONFIG_TARGET_FY01=y
CONFIG_DEFAULT_DEVICE_TREE="molchip-v2p-ca7s-fy01"
CONFIG_SPL_SYS_MALLOC_F_LEN=0x400
CONFIG_TPL_SYS_MALLOC_F_LEN=0x400
CONFIG_SPI_BOOT=y
CONFIG_BOOTDELAY=0
# CONFIG_DISPLAY_CPUINFO is not set
# CONFIG_DISPLAY_BOARDINFO is not set
CONFIG_BOARD_EARLY_INIT_F=y
CONFIG_SPL=y
# CONFIG_SPL_RAW_IMAGE_SUPPORT is not set
# CONFIG_SPL_LEGACY_IMAGE_SUPPORT is not set
CONFIG_PDL=y
CONFIG_PDL_TEXT_BASE=0x38B00100
CONFIG_PDL_STACK=0x38B08000
CONFIG_SDL=y
CONFIG_SDL_TEXT_BASE=0x80000000
CONFIG_SDL_STACK=0x80005000
CONFIG_SYS_PROMPT="uboot#"
# CONFIG_CMD_CONSOLE is not set
# CONFIG_CMD_BOOTD is not set
CONFIG_CMD_BOOTZ=y
# CONFIG_CMD_IMLS is not set
# CONFIG_CMD_XIMG is not set
# CONFIG_CMD_EDITENV is not set
# CONFIG_CMD_ENV_EXISTS is not set
CONFIG_CRC32_VERIFY=y
# CONFIG_CMD_FLASH is not set
# CONFIG_CMD_FPGA is not set
# CONFIG_CMD_LOADB is not set
# CONFIG_CMD_LOADS is not set
CONFIG_CMD_SF=y
# CONFIG_CMD_ITEST is not set
# CONFIG_CMD_SETEXPR is not set
CONFIG_CMD_TFTPPUT=y
CONFIG_CMD_TFTPSRV=y
CONFIG_CMD_RARP=y
CONFIG_CMD_DHCP=y
CONFIG_CMD_PXE=y
CONFIG_CMD_MII=y
CONFIG_CMD_PING=y
CONFIG_CMD_CDP=y
CONFIG_CMD_SNTP=y
CONFIG_CMD_DNS=y
CONFIG_CMD_LINK_LOCAL=y
CONFIG_CMD_ETHSW=y
# CONFIG_CMD_MISC is not set
# CONFIG_PARTITIONS is not set
CONFIG_OF_CONTROL=y
CONFIG_NET_RANDOM_ETHADDR=y
CONFIG_NETCONSOLE=y
CONFIG_DM=y
CONFIG_MOLCHIP_DMA=y
# CONFIG_MMC is not set
CONFIG_MC_SFC_FLASH=y
CONFIG_PHY_REALTEK=y
CONFIG_PHY_MOLCHIP=y
CONFIG_DM_ETH=y
CONFIG_ETH_DESIGNWARE=y
CONFIG_GMAC_MOLCHIP=y
# CONFIG_SPL_SERIAL_PRESENT is not set
CONFIG_DM_SERIAL=y
# CONFIG_SPL_DM_SERIAL is not set
CONFIG_MOLCHIP_SPI=y
# CONFIG_REGEX is not set
# CONFIG_EFI_LOADER is not set
```
