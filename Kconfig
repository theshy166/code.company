## base/soc/qm10xd/linux/bsp/uboot/uboot/configs/molchip_fy02b_defconfig
```kconfig
CONFIG_ARM=y
CONFIG_SYS_CONFIG_NAME="fy02"
CONFIG_ARCH_MOLCHIP=y
CONFIG_SYS_MALLOC_F_LEN=0x8000
CONFIG_TARGET_FY02B=y
CONFIG_DEFAULT_DEVICE_TREE="molchip-v2p-ca7s-fy02"
CONFIG_SPL_SYS_MALLOC_F_LEN=0x400
CONFIG_TPL_SYS_MALLOC_F_LEN=0x400
CONFIG_SPI_BOOT=y
CONFIG_BOOTDELAY=0
# CONFIG_DISPLAY_CPUINFO is not set
# CONFIG_DISPLAY_BOARDINFO is not set
CONFIG_BOARD_EARLY_INIT_F=y
CONFIG_SPL=y
# CONFIG_SPL_RAW_IMAGE_SUPPORT is not set
# CONFIG_SPL_LEGACY_IMAGE_SUPPORT is not set
CONFIG_PDL=y
CONFIG_PDL_TEXT_BASE=0x38a00100
CONFIG_PDL_STACK=0x38a08000
CONFIG_SDL=y
CONFIG_SDL_TEXT_BASE=0x40000100
CONFIG_SDL_STACK=0x41005000
CONFIG_SYS_PROMPT="uboot#"
# CONFIG_CMD_CONSOLE is not set
# CONFIG_CMD_BOOTD is not set
CONFIG_CMD_BOOTZ=y
# CONFIG_CMD_IMLS is not set
# CONFIG_CMD_XIMG is not set
# CONFIG_CMD_EDITENV is not set
# CONFIG_CMD_ENV_EXISTS is not set
CONFIG_CRC32_VERIFY=y
# CONFIG_CMD_FLASH is not set
# CONFIG_CMD_FPGA is not set
# CONFIG_CMD_LOADB is not set
# CONFIG_CMD_LOADS is not set
CONFIG_CMD_SF=y
# CONFIG_CMD_ITEST is not set
# CONFIG_CMD_SETEXPR is not set
CONFIG_CMD_TFTPPUT=y
CONFIG_CMD_TFTPSRV=y
CONFIG_CMD_RARP=y
CONFIG_CMD_DHCP=y
CONFIG_CMD_PXE=y
CONFIG_CMD_MII=y
CONFIG_CMD_PING=y
CONFIG_CMD_CDP=y
CONFIG_CMD_SNTP=y
CONFIG_CMD_DNS=y
CONFIG_CMD_LINK_LOCAL=y
CONFIG_CMD_ETHSW=y
# CONFIG_CMD_MISC is not set
# CONFIG_PARTITIONS is not set
CONFIG_OF_CONTROL=y
CONFIG_ENV_IS_IN_SPI_FLASH=y
CONFIG_NET_RANDOM_ETHADDR=y
CONFIG_NETCONSOLE=y
CONFIG_DM=y
CONFIG_MOLCHIP_DMA=y
# CONFIG_MMC is not set
CONFIG_NAND=y
CONFIG_MC_SPI_NFC_NAND=y
CONFIG_MC_SFC_FLASH=y
CONFIG_PHY_REALTEK=y
CONFIG_PHY_MOLCHIP=y
CONFIG_DM_ETH=y
CONFIG_ETH_DESIGNWARE=y
CONFIG_GMAC_MOLCHIP=y
# CONFIG_SPL_SERIAL_PRESENT is not set
CONFIG_DM_SERIAL=y
# CONFIG_SPL_DM_SERIAL is not set
CONFIG_MOLCHIP_SPI=y
# CONFIG_REGEX is not set
# CONFIG_EFI_LOADER is not set
CONFIG_MOL_ICACHE_OFF=y
CONFIG_MOL_DCACHE_OFF=y
```
