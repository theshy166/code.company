## build/kconf/Kconfig.product
```kconfig
#XOS Product Configure
#
menu "XOS Product"

choice
    prompt "XOS Product"
    default PRODUCT_AICAMERA

config PRODUCT_AICAMERA
    bool "aicamera"
    ## select XOS_USE_APP_AICAMERA
    ## add select more features here
    help
      Configuration for aicamera.

config PRODUCT_DEMO
    bool "demo"
    help
      Configuration for demo.

config PRODUCT_CAMERA
    bool "camera"
    help
      Configuration for camera.

config PRODUCT_NXF7
    bool "nxf7"
    help
      Configuration for nxf7.

config PRODUCT_NXF7E
    bool "nxf7e"
    help
      Configuration for nxf7e.

config PRODUCT_MOMOTALK
    bool "momotalk"
    help
      Configuration for momotalk.

config PRODUCT_KIDCAMERA
    bool "aicamera"
    ## select XOS_USE_APP_AICAMERA
    ## add select more features here
    help
      Configuration for kidcamera.

config PRODUCT_KIDCAMERA_NOR
    bool "aicamera"
    ## select XOS_USE_APP_AICAMERA
    ## add select more features here
    help
      Configuration for kidcamera_nor.

config PRODUCT_STUDYPILOT
    bool "studypilot"
    help
      Set the product.

config PRODUCT_AIGLASSES_LV
    bool "aicamera"
    ## select XOS_USE_APP_AICAMERA
    ## add select more features here
    help
      Configuration for aiglasses_lv.

config PRODUCT_QM10XV_EVB
    bool "qm10xv_evb"
    help
      Configuration for qm10xv evb.

config PRODUCT_D629
    bool "d629"
    help
      Configuration for d629.

config PRODUCT_SPHOTO
    bool "sphoto"
    help
      Configuration for sphoto.

config PRODUCT_XMPHOTO
    bool "xmphoto"
    help
      Configuration for xmphoto.

config PRODUCT_MOTOX
    bool "motox"
    help
      Configuration for motox.

config PRODUCT_IPC
    bool "ipc"
    help
      Configuration for ipc.

config PRODUCT_GALLERY
    bool "gallery"
    help
      Configuration for gallery.

config PRODUCT_SMARTHOME
    bool "smarthome"
    help
      Configuration for smarthome.

config PRODUCT_SIMULATOR
    bool "simulator"
    help
      Configuration for simulator.

config PRODUCT_MOTO
    bool "moto"
    help
      Configuration for moto.

config PRODUCT_WIFIX
    bool "wifix"
    help
      Configuration for wifix.

config PRODUCT_ESL
    bool "esl"
    help
      Configuration for esl.

config PRODUCT_ESL2
    bool "esl2"
    help
      Configuration for esl.

config PRODUCT_SMARTDOOR
    bool "smartdoor"
    help
      Configuration for smartdoor.

config PRODUCT_SMARTLOCK
    bool "smartlock"
    help
      Configuration for smartlock.

config PRODUCT_PETROBOT
    bool "petrobot"
    help
      Configuration for petrobot.

config PRODUCT_XKPHOTO
    bool "xkphoto"
    help
      Configuration for xkphoto.

config PRODUCT_XHOME
    bool "xhome"
    help
      Configuration for xhome.

config PRODUCT_WIFINVR
    bool "wifinvr"
    help
      Configuration for wifinvr.

config PRODUCT_AIGLASSES_LH
    bool "aiglasses lh"
    help
      Configuration for aiglasses(qm108h linux).

config PRODUCT_MOTOX102D
    bool "motox102d"
    help
      Configuration for motox102d.

config PRODUCT_MOTOX_RD
    bool "motox_rd"
    help
      Configuration for motox_rd

config PRODUCT_MOTOX_LD
    bool "motox_ld"
    help
      Configuration for motox_ld

config PRODUCT_CB1_LD
    bool "cb1_ld"
    help
      Configuration for cb1_ld

config PRODUCT_CB1_LV
    bool "cb1_lv"
    help
      Configuration for cb1_lv

config PRODUCT_QM102D_BASE
    bool "qm102d_base"
    help
      Configuration for qm102d_base
endchoice

endmenu

# Include configuration if selected
source "product/.Kconfig"
source "build/kconf/Kconfig.base"
source "build/kconf/Kconfig.core"
```

## build/kconf/Kconfig.recovery
```kconfig
#
# For a description of the syntax of this configuration file,
# core/package/recovery configuration.
#

menu "Recovery"

config XOS_RECOVERY_MODE
	bool "recovery mode"
	default y
	help
		Select the xos recovery mode feature.

config XOS_UPDATE_ENGINE
	bool "update engine"
	default y
	help
		Select the xos update engine feature.

endmenu
```

## build/kconf/Kconfig.res
```kconfig
#
# For a description of the syntax of this configuration file,
# core/package/inner configuration.
#
menu "resource"

config XOS_USE_INNER_RES
    bool "resource"
    default y
      help
      Select the xos framework resource package.

endmenu
```

## build/kconf/Kconfig.rootfs
```kconfig
menu "Rootfs"

config ROOTFS_VERSION
        string "ROOTFS version"
        default "v1.0"
        help
          Enter rootfs version

config ROOTFS_BUSYBOX_CONFIG
        string "Config file"
        default "busybox_quaming_config"
        help
          Enter the name of the _config file, eg:
          busybox_quaming_config

config ROOTFS_BUSYBOX_VERSION
        string "Busybox version"
        default "v1.0"

config ROOTFS_FORMAT
        string "Compressed format"
        default "xz"
        help
          Enter the compressed format, eg:
          xz
          lz4
          ubifs

config XOS_SQUASHFS_USE_LZO_COMPR
        bool "Squashfs compressed format"

## Please add new fs type here
## TODO


endmenu
```

## build/kconf/Kconfig.rtt
```kconfig
## uboot config files
source "build/kconf/Kconfig.uboot"
## kernel config files
source "build/kconf/Kconfig.kernel"
## select rootfs
#source "build/kconf/Kconfig.rootfs"
##   
## add more here
#
#TODO
```

## build/kconf/Kconfig.sdk
```kconfig
#base soc system select
#
menu "SoC System"

source "build/kconf/Kconfig.chipset"
source "build/kconf/Kconfig.os"
source "build/kconf/Kconfig.toolchain"
source "build/kconf/Kconfig.misc"
##
#add more sub menu config here

endmenu
```
