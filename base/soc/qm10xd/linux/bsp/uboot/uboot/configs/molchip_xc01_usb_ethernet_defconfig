## base/soc/qm10xd/linux/bsp/uboot/uboot/configs/molchip_xc01_usb_ethernet_defconfig
```kconfig
CONFIG_ARM=y
CONFIG_SYS_CONFIG_NAME="xc01"
CONFIG_SPL_SYS_THUMB_BUILD=y
CONFIG_ARCH_MOLCHIP=y
CONFIG_SYS_MALLOC_F_LEN=0x8000
CONFIG_TARGET_XC01=y
# CONFIG_SELECT_LOAD_UBOOT is not set
# CONFIG_BOOT_STAGE_LOAD_NN is not set
CONFIG_DEFAULT_DEVICE_TREE="molchip-v2p-ca7s-xc01"
CONFIG_SPL_SYS_MALLOC_F_LEN=0x400
CONFIG_TPL_SYS_MALLOC_F_LEN=0x400
CONFIG_SPI_BOOT=y
CONFIG_BOOTDELAY=0
# CONFIG_DISPLAY_CPUINFO is not set
# CONFIG_DISPLAY_BOARDINFO is not set
CONFIG_BOARD_EARLY_INIT_F=y
CONFIG_SPL=y
CONFIG_PDL=y
CONFIG_PDL_TEXT_BASE=0x30000800
CONFIG_PDL_STACK=0x30008000
CONFIG_SDL=y
CONFIG_SDL_TEXT_BASE=0x40000800
CONFIG_SDL_STACK=0x41005000
CONFIG_SDL_MMC_SUPPORT=y
CONFIG_SYS_PROMPT="uboot#"
# CONFIG_CMD_CONSOLE is not set
# CONFIG_CMD_BOOTD is not set
CONFIG_CMD_BOOTZ=y
# CONFIG_CMD_IMLS is not set
# CONFIG_CMD_XIMG is not set
# CONFIG_CMD_EDITENV is not set
# CONFIG_CMD_ENV_EXISTS is not set
CONFIG_CRC32_VERIFY=y
# CONFIG_CMD_FLASH is not set
# CONFIG_CMD_FPGA is not set
# CONFIG_CMD_LOADB is not set
# CONFIG_CMD_LOADS is not set
CONFIG_CMD_MMC=y
CONFIG_CMD_MC_MMC_DL_SCAN=y
CONFIG_CMD_SF=y
CONFIG_CMD_USB=y
# CONFIG_CMD_ITEST is not set
# CONFIG_CMD_SETEXPR is not set
CONFIG_CMD_TFTPPUT=y
CONFIG_CMD_TFTPSRV=y
CONFIG_CMD_RARP=y
CONFIG_CMD_DHCP=y
CONFIG_CMD_PXE=y
CONFIG_CMD_MII=y
CONFIG_CMD_PING=y
CONFIG_CMD_CDP=y
CONFIG_CMD_SNTP=y
CONFIG_CMD_DNS=y
CONFIG_CMD_LINK_LOCAL=y
CONFIG_CMD_ETHSW=y
# CONFIG_CMD_MISC is not set
CONFIG_CMD_FAT=y
CONFIG_OF_CONTROL=y
CONFIG_ENV_IS_IN_MMC=y
CONFIG_NET_RANDOM_ETHADDR=y
CONFIG_NETCONSOLE=y
CONFIG_DM=y
CONFIG_MOLCHIP_DMA=y
CONFIG_MISC=y
CONFIG_MOLCHIP_EFUSE=y
CONFIG_DM_MMC=y
CONFIG_MMC_DW=y
CONFIG_MMC_SDMMC_MC=y
CONFIG_MMC_SDHCI=y
CONFIG_MMC_SDHCI_SDMA=y
CONFIG_MMC_SDHCI_MC=y
CONFIG_MTD=y
CONFIG_NAND=y
CONFIG_MC_SPI_NFC_NAND=y
CONFIG_MC_SFC_FLASH=y
# CONFIG_SPL_SERIAL_PRESENT is not set
CONFIG_DM_SERIAL=y
# CONFIG_SPL_DM_SERIAL is not set
CONFIG_MOLCHIP_SPI=y
CONFIG_USB=y
CONFIG_DM_USB=y
CONFIG_USB_XHCI_HCD=y
CONFIG_USB_XHCI_DWC3=y
CONFIG_USB_STORAGE=y
CONFIG_USB_HOST_ETHER=y
CONFIG_USB_ETHER_ASIX=y
CONFIG_USB_PHY=y
CONFIG_MOLCHIP_USB3_PHY=y
CONFIG_FAT_WRITE=y
# CONFIG_REGEX is not set
# CONFIG_EFI_LOADER is not set
```

## base/soc/qm10xd/linux/bsp/uboot/uboot/configs/quaming_qm108h_defconfig
```kconfig
CONFIG_ARM=y
CONFIG_SYS_CONFIG_NAME="xc01"
CONFIG_SPL_SYS_THUMB_BUILD=y
CONFIG_ARCH_MOLCHIP=y
CONFIG_SYS_MALLOC_F_LEN=0x8000
CONFIG_SPL_NAND_SUPPORT=y
CONFIG_TARGET_XC01=y
# CONFIG_SELECT_LOAD_UBOOT is not set
# CONFIG_BOOT_STAGE_LOAD_NN is not set
CONFIG_BOOT_RAM_SIZE=0x2000000
CONFIG_DEFAULT_DEVICE_TREE="molchip-v2p-ca7s-xc01"
CONFIG_SPL_SYS_MALLOC_F_LEN=0x400
CONFIG_TPL_SYS_MALLOC_F_LEN=0x400
CONFIG_SPI_BOOT=y
CONFIG_BOOTDELAY=0
CONFIG_USE_BOOTARGS=y
CONFIG_BOOTARGS="mem=48M earlycon console=ttyS0,115200"
CONFIG_BOOTATAGS_FH=y
# CONFIG_DISPLAY_CPUINFO is not set
# CONFIG_DISPLAY_BOARDINFO is not set
CONFIG_BOARD_EARLY_INIT_F=y
CONFIG_SPL=y
CONFIG_SPL_MTD_SUPPORT=y
CONFIG_PDL=y
CONFIG_PDL_TEXT_BASE=0x30000800
CONFIG_PDL_STACK=0x30008000
CONFIG_SDL=y
CONFIG_SDL_TEXT_BASE=0x40000800
CONFIG_SDL_STACK=0x30010000
CONFIG_SDL_NAND_SUPPORT=y
CONFIG_SDL_MMC_SUPPORT=y
CONFIG_SYS_PROMPT="uboot#"
# CONFIG_CMD_CONSOLE is not set
# CONFIG_CMD_BOOTD is not set
CONFIG_CMD_BOOTZ=y
# CONFIG_CMD_IMLS is not set
# CONFIG_CMD_XIMG is not set
# CONFIG_CMD_EDITENV is not set
# CONFIG_CMD_ENV_EXISTS is not set
CONFIG_CRC32_VERIFY=y
# CONFIG_CMD_FLASH is not set
# CONFIG_CMD_FPGA is not set
# CONFIG_CMD_LOADB is not set
# CONFIG_CMD_LOADS is not set
CONFIG_CMD_MMC=y
CONFIG_CMD_MC_MMC_DL_SCAN=y
# CONFIG_CMD_NAND is not set
CONFIG_CMD_SF=y
CONFIG_CMD_USB=y
# CONFIG_CMD_ITEST is not set
# CONFIG_CMD_SETEXPR is not set
CONFIG_CMD_TFTPPUT=y
CONFIG_CMD_TFTPSRV=y
CONFIG_CMD_RARP=y
CONFIG_CMD_DHCP=y
CONFIG_CMD_PXE=y
CONFIG_CMD_MII=y
CONFIG_CMD_PING=y
CONFIG_CMD_CDP=y
CONFIG_CMD_SNTP=y
CONFIG_CMD_DNS=y
CONFIG_CMD_LINK_LOCAL=y
CONFIG_CMD_ETHSW=y
# CONFIG_CMD_MISC is not set
CONFIG_CMD_FAT=y
CONFIG_OF_CONTROL=y
CONFIG_ENV_IS_IN_MMC=y
CONFIG_NET_RANDOM_ETHADDR=y
CONFIG_NETCONSOLE=y
CONFIG_DM=y
CONFIG_MOLCHIP_DMA=y
CONFIG_DM_GPIO=y
CONFIG_MOLCHIP_GPIO=y
CONFIG_MISC=y
CONFIG_MOLCHIP_EFUSE=y
CONFIG_MOLCHIP_AES=y
CONFIG_MOLCHIP_HASH=y
CONFIG_MOLCHIP_LZMA=y
CONFIG_DM_MMC=y
CONFIG_MMC_DW=y
CONFIG_MMC_SDMMC_MC=y
CONFIG_SUPPORT_EMMC_BOOT=y
CONFIG_MMC_SDHCI=y
CONFIG_MMC_SDHCI_SDMA=y
CONFIG_MMC_SDHCI_MC=y
CONFIG_MTD=y
CONFIG_NAND=y
CONFIG_MC_SPI_NFC_NAND=y
CONFIG_MC_SFC_FLASH=y
CONFIG_PHY_REALTEK=y
CONFIG_PHY_MOLCHIP=y
CONFIG_DM_ETH=y
CONFIG_ETH_DESIGNWARE=y
CONFIG_GMAC_MOLCHIP=y
CONFIG_DM_RTC=y
CONFIG_RTC_MOLCHIP_V1=y
# CONFIG_SPL_SERIAL_PRESENT is not set
CONFIG_DM_SERIAL=y
# CONFIG_SPL_DM_SERIAL is not set
CONFIG_MOLCHIP_SPI=y
CONFIG_USB=y
CONFIG_DM_USB=y
CONFIG_USB_XHCI_HCD=y
CONFIG_USB_XHCI_DWC3=y
CONFIG_USB_STORAGE=y
CONFIG_USB_HOST_ETHER=y
CONFIG_USB_ETHER_ASIX=y
CONFIG_USB_PHY=y
CONFIG_MOLCHIP_USB3_PHY=y
CONFIG_FAT_WRITE=y
# CONFIG_REGEX is not set
CONFIG_FDT_FIXUP_PARTITIONS=y
# CONFIG_EFI_LOADER is not set
```

## base/soc/qm10xd/linux/bsp/uboot/uboot/configs/quaming_qm10xd_cb1_ld_defconfig
```kconfig
CONFIG_ARM=y
CONFIG_SYS_CONFIG_NAME="lt00"
CONFIG_SPL_SYS_THUMB_BUILD=y
CONFIG_ARCH_MOLCHIP=y
# CONFIG_MOL_ICACHE_OFF is not set
# CONFIG_MOL_DCACHE_OFF is not set
CONFIG_MOLCHIP_FASTBOOT=y
CONFIG_SYS_MALLOC_F_LEN=0x8000
CONFIG_SPL_NAND_SUPPORT=y
CONFIG_TARGET_LT00=y
# CONFIG_SELECT_LOAD_UBOOT is not set
# CONFIG_BOOT_STAGE_LOAD_NN is not set
CONFIG_BOOT_RAM_SIZE=0x2000000
CONFIG_DEFAULT_DEVICE_TREE="molchip-v2p-ca7s-lt00"
CONFIG_SPL_SYS_MALLOC_F_LEN=0x400
CONFIG_TPL_SYS_MALLOC_F_LEN=0x400
CONFIG_SPI_BOOT=y
CONFIG_BOOTDELAY=0
CONFIG_USE_BOOTARGS=y
CONFIG_BOOTARGS="loglevel=4 mem=33M earlycon console=ttyS0,115200 root=/dev/mtdblock5 rootfstype=squashfs user_debug=31"
# CONFIG_DISPLAY_CPUINFO is not set
# CONFIG_DISPLAY_BOARDINFO is not set
CONFIG_BOARD_EARLY_INIT_F=y
CONFIG_SPL=y
CONFIG_SPL_MTD_SUPPORT=y
CONFIG_PDL=y
CONFIG_PDL_TEXT_BASE=0x27000800
CONFIG_PDL_STACK=0x27008000
CONFIG_SDL=y
CONFIG_SDL_TEXT_BASE=0x40000400
CONFIG_SDL_STACK=0x41000000
CONFIG_SDL_NAND_SUPPORT=y
CONFIG_SYS_PROMPT="uboot#"
# CONFIG_CMD_CONSOLE is not set
# CONFIG_CMD_BOOTD is not set
CONFIG_CMD_BOOTZ=y
# CONFIG_CMD_IMLS is not set
# CONFIG_CMD_XIMG is not set
# CONFIG_CMD_EDITENV is not set
# CONFIG_CMD_ENV_EXISTS is not set
CONFIG_CRC32_VERIFY=y
# CONFIG_CMD_FLASH is not set
# CONFIG_CMD_FPGA is not set
CONFIG_CMD_LOADB=y
# CONFIG_CMD_LOADS is not set
# CONFIG_CMD_NAND is not set
# CONFIG_CMD_MMC is not set
CONFIG_CMD_SF=y
CONFIG_CMD_USB=y
# CONFIG_CMD_ITEST is not set
# CONFIG_CMD_SETEXPR is not set
CONFIG_CMD_TFTPPUT=y
CONFIG_CMD_TFTPSRV=y
CONFIG_CMD_RARP=y
# CONFIG_CMD_DHCP is not set
CONFIG_CMD_PXE=y
# CONFIG_CMD_MII is not set
# CONFIG_CMD_PING is not set
CONFIG_CMD_CDP=y
# CONFIG_CMD_SNTP is not set
# CONFIG_CMD_DNS is not set
# CONFIG_CMD_LINK_LOCAL is not set
# CONFIG_CMD_ETHSW is not set
CONFIG_CMD_CACHE=y
# CONFIG_CMD_MISC is not set
CONFIG_CMD_FAT=y
CONFIG_OF_CONTROL=y
CONFIG_ENV_IS_IN_SPI_FLASH=y
# CONFIG_NET_RANDOM_ETHADDR is not set
# CONFIG_NETCONSOLE is not set
CONFIG_DM=y
CONFIG_MOLCHIP_DMA=y
CONFIG_MOLCHIP_GPIO=y
CONFIG_MISC=y
CONFIG_MOLCHIP_EFUSE=y
CONFIG_MOLCHIP_AES=y
CONFIG_DM_MMC=y
CONFIG_MMC_DW=y
CONFIG_MMC_SDMMC_MC=y
CONFIG_MTD=y
CONFIG_CMD_LZMADEC=y
# CONFIG_NOR is not set
CONFIG_MC_SPI_NFC_NAND=y
CONFIG_MC_SFC_FLASH=y
# CONFIG_PHY_REALTEK is not set
# CONFIG_PHY_MOLCHIP is not set
# CONFIG_DM_ETH is not set
# CONFIG_ETH_DESIGNWARE is not set
# CONFIG_GMAC_MOLCHIP is not set
# CONFIG_GMAC_MOLCHIP_FDT is not set
CONFIG_DM_PWM=y
CONFIG_PWM_MOLCHIP=y
CONFIG_DM_RTC=y
CONFIG_RTC_MOLCHIP_V1=y
# CONFIG_SPL_SERIAL_PRESENT is not set
CONFIG_DM_SERIAL=y
# CONFIG_SPL_DM_SERIAL is not set
CONFIG_MOLCHIP_SPI=y
CONFIG_USB=y
CONFIG_DM_USB=y
# CONFIG_USB_XHCI_HCD is not set
# CONFIG_USB_XHCI_DWC3 is not set
CONFIG_USB_MOLCHIP_DWC2=y
CONFIG_USB_STORAGE=y
# CONFIG_USB_HOST_ETHER is not set
# CONFIG_USB_ETHER_ASIX is not set
CONFIG_USB_PHY=y
# CONFIG_MOLCHIP_USB3_PHY is not set
CONFIG_FAT_WRITE=y
# CONFIG_REGEX is not set
CONFIG_FDT_FIXUP_PARTITIONS=y
# CONFIG_EFI_LOADER is not set
CONFIG_CMD_GPIO=y
# CONFIG_UBOOT_WIFIX is not set
CONFIG_USB_FLASH=y
# CONFIG_SD_FLASH is not set
CONFIG_CMD_BLINKLED=y
CONFIG_QUA_LOGO=y
CONFIG_QUA_LOGO_PART=y
CONFIG_QUA_LOGO_MIPI_JD9365D=y
# CONFIG_QUA_LCM_2ND_SCR is not set
# CONFIG_OTA_SCRIPT_CMD is not set
# CONFIG_FLASH_DEV_MODE_DETECT is not set

CONFIG_NOR_UPDATE=y
CONFIG_NAND=y
CONFIG_UBOOT_CB1LD=y
```

## base/soc/qm10xd/linux/bsp/uboot/uboot/configs/quaming_qm10xd_esl_defconfig
```kconfig
CONFIG_ARM=y
CONFIG_SYS_CONFIG_NAME="lt00"
CONFIG_SPL_SYS_THUMB_BUILD=y
CONFIG_ARCH_MOLCHIP=y
# CONFIG_MOL_ICACHE_OFF is not set
CONFIG_MOL_DCACHE_OFF=y
CONFIG_MOLCHIP_FASTBOOT=y
CONFIG_SYS_MALLOC_F_LEN=0x8000
CONFIG_SPL_NAND_SUPPORT=y
CONFIG_TARGET_LT00=y
# CONFIG_SELECT_LOAD_UBOOT is not set
# CONFIG_BOOT_STAGE_LOAD_NN is not set
CONFIG_BOOT_RAM_SIZE=0x2000000
CONFIG_DEFAULT_DEVICE_TREE="molchip-v2p-ca7s-lt00"
CONFIG_SPL_SYS_MALLOC_F_LEN=0x400
CONFIG_TPL_SYS_MALLOC_F_LEN=0x400
CONFIG_SPI_BOOT=y
CONFIG_BOOTDELAY=0
CONFIG_USE_BOOTARGS=y
CONFIG_BOOTARGS="loglevel=4 ubi.mtd=7 ubi.mtd=9 ubi.mtd=11 ubi.mtd=12 root=ubi2:rootfs init=/init rootfstype=ubifs mem=28M earlycon console=ttyS0,115200 mtdparts=spi_nfc:32k@0(boot-spl),128k@128k(boot-env),768k@256k(boot-uboot),1m@1m(logo),1m@2m(padding),1m@3m(misc),3m@4m(recovery),10m@7m(recovery-rootfs),4m@17m(boot),18m@21m(system),6m@39m(swapfile),6m@45m(rootfs),-@51m(data)"
# CONFIG_DISPLAY_CPUINFO is not set
# CONFIG_DISPLAY_BOARDINFO is not set
CONFIG_BOARD_EARLY_INIT_F=y
CONFIG_SPL=y
CONFIG_SPL_MTD_SUPPORT=y
CONFIG_PDL=y
CONFIG_PDL_TEXT_BASE=0x27000800
CONFIG_PDL_STACK=0x27008000
CONFIG_SDL=y
CONFIG_SDL_TEXT_BASE=0x40000400
CONFIG_SDL_STACK=0x41000000
CONFIG_SDL_NAND_SUPPORT=y
CONFIG_SYS_PROMPT="uboot#"
# CONFIG_CMD_CONSOLE is not set
# CONFIG_CMD_BOOTD is not set
CONFIG_CMD_BOOTZ=y
# CONFIG_CMD_IMLS is not set
# CONFIG_CMD_XIMG is not set
# CONFIG_CMD_EDITENV is not set
# CONFIG_CMD_ENV_EXISTS is not set
CONFIG_CRC32_VERIFY=y
# CONFIG_CMD_FLASH is not set
# CONFIG_CMD_FPGA is not set
# CONFIG_CMD_LOADB is not set
# CONFIG_CMD_LOADS is not set
CONFIG_CMD_NAND=y
CONFIG_CMD_MMC=y
CONFIG_CMD_SF=y
CONFIG_CMD_USB=y
# CONFIG_CMD_ITEST is not set
# CONFIG_CMD_SETEXPR is not set
CONFIG_CMD_TFTPPUT=y
CONFIG_CMD_TFTPSRV=y
CONFIG_CMD_RARP=y
CONFIG_CMD_DHCP=y
CONFIG_CMD_PXE=y
CONFIG_CMD_MII=y
CONFIG_CMD_PING=y
CONFIG_CMD_CDP=y
CONFIG_CMD_SNTP=y
CONFIG_CMD_DNS=y
CONFIG_CMD_LINK_LOCAL=y
CONFIG_CMD_ETHSW=y
CONFIG_CMD_CACHE=y
# CONFIG_CMD_MISC is not set
CONFIG_CMD_FAT=y
CONFIG_CMD_UBI=y
CONFIG_CMD_UBIFS=y
CONFIG_OF_CONTROL=y
# CONFIG_ENV_IS_IN_SPI_FLASH is not set
CONFIG_ENV_IS_IN_NAND=y
CONFIG_NET_RANDOM_ETHADDR=y
CONFIG_NETCONSOLE=y
CONFIG_DM=y
CONFIG_MOLCHIP_DMA=y
CONFIG_MOLCHIP_GPIO=y
CONFIG_MISC=y
CONFIG_MOLCHIP_EFUSE=y
CONFIG_MOLCHIP_AES=y
CONFIG_DM_MMC=y
CONFIG_MMC_DW=y
CONFIG_MMC_SDMMC_MC=y
CONFIG_MTD=y
CONFIG_MTD_DEVICE=y
CONFIG_MTD_PARTITIONS=y
CONFIG_CMD_MTDPARTS=y
CONFIG_MTDPARTS_DEFAULT="mtdparts=spi_nfc:128k(boot-spl),128k(boot-env),768k(boot-uboot),1m(logo),1m(padding),1m(misc),3m(recovery),10m(recovery-rootfs),4m(boot),18m(system),6m(swapfile),6m(rootfs),77m(data)"
CONFIG_MTDIDS_DEFAULT="nand0=spi_nfc"
CONFIG_CMD_LZMADEC=y
CONFIG_OTA_SCRIPT_CMD=y
# CONFIG_CMD_UNZIP=y
CONFIG_NAND=y
CONFIG_MC_SPI_NFC_NAND=y
CONFIG_MC_SFC_FLASH=y
CONFIG_PHY_REALTEK=y
CONFIG_PHY_MOLCHIP=y
CONFIG_DM_ETH=y
CONFIG_ETH_DESIGNWARE=y
CONFIG_GMAC_MOLCHIP=y
# CONFIG_GMAC_MOLCHIP_FDT is not set
CONFIG_DM_PWM=y
CONFIG_PWM_MOLCHIP=y
CONFIG_DM_RTC=y
CONFIG_RTC_MOLCHIP_V1=y
# CONFIG_SPL_SERIAL_PRESENT is not set
CONFIG_DM_SERIAL=y
# CONFIG_SPL_DM_SERIAL is not set
CONFIG_MOLCHIP_SPI=y
CONFIG_USB=y
CONFIG_DM_USB=y
# CONFIG_USB_XHCI_HCD is not set
# CONFIG_USB_XHCI_DWC3 is not set
CONFIG_USB_MOLCHIP_DWC2=y
CONFIG_USB_STORAGE=y
# CONFIG_USB_HOST_ETHER is not set
# CONFIG_USB_ETHER_ASIX is not set
CONFIG_USB_PHY=y
# CONFIG_MOLCHIP_USB3_PHY is not set
CONFIG_FAT_WRITE=y
# CONFIG_REGEX is not set
CONFIG_FDT_FIXUP_PARTITIONS=y
# CONFIG_EFI_LOADER is not set
CONFIG_CMD_GPIO=y
# CONFIG_UBOOT_WIFIX is not set
CONFIG_USB_FLASH=y
CONFIG_FLASH_FW_ON_KEY_PRESS=y
CONFIG_CMD_BLINKLED=y
CONFIG_LED_INDICATOR_FOR_FLASH=y
CONFIG_LED_INDICATOR_GPIO=39
CONFIG_QUA_LOGO=y
CONFIG_QUA_LOGO_MIPI_JD9365D=y
CONFIG_QUA_LOGO_MIPI_JD9365D_PWR_CTRL=y
CONFIG_QUA_LCM_2ND_SCR=y
CONFIG_QUA_LOGO_PART=y
CONFIG_UBOOT_ESL=y
CONFIG_WRITE_SN=y
CONFIG_INIT_GPIOS=y
CONFIG_INIT_PINDRIVING=y
```

## build/kconf/Kconfig
```kconfig
#
# For a description of the syntax of this configuration file,
# see Documentation/kbuild/kconfig-language.txt.
#
# mainmenu "XOS Kconfig Configuration."


source "build/kconf/Kconfig.product"
```
