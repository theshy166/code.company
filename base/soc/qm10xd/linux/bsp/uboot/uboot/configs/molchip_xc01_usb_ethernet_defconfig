## build/kconf/Kconfig.apps
```kconfig
#
# For a description of the syntax of this configuration file,
# apps configuration.
#

if !XOS_USE_NO_QUAUI

menu "Apps Package"

config XOS_USE_APP_AIBOX
	bool "Aibox"
	default n
	help
		Select the app aibox.

config XOS_USE_APP_AICAMERA
	bool "Aicamera"
	default n
	help
		Select the app aicamera.

config XOS_USE_APP_SITTINGPC
	bool "Sitting PC"
	default n
	help 
		Select the app sittingpc

config XOS_USE_APP_ALARM
	bool "Alarm"
	default n
	help
		Select the app alarm.

config XOS_USE_APP_ANALOG_CLOCK
	bool "Analog Clock"
	default n
	help
		Select the app analog alock.

config XOS_USE_APP_AUDIO_PLAYER
	bool "Audio Player"
	default n
	help
		Select the app audio player.

config XOS_APP_XIAOMING
	bool "Xiaoming"
	default n
	help
		Select the app xiaoming.

config XOS_USE_APP_BOOT_ANIMATE
	bool "Boot Animate"
	default n
	help
		Select the app animate.

config XOS_USE_APP_CALCULATOR
	bool "Calculator"
	default n
	help
		Select the app calculator.

config XOS_USE_APP_CALENDAR
	bool "Calendar"
	default n
	help
		Select the app smart home.

config XOS_USE_APP_CAMERA
	bool "Camera"
	default n
	help
		Select the app camera.

config XOS_USE_CAMERA
	bool "camera2"
	default n
	help
		Select the xos use camera.

config XOS_USE_APP_COFFEE_MILL
	bool "Coffee mill"
	default n
	help
		Select the app coffee mill.

config XOS_USE_APP_COOLFLORID
	bool "Coolflorid"
	default n
	help
		Select the app coolflorid.

config XOS_USE_APP_DEMO
	bool "Demo"
	default n
	help
		Select the app demo.

config XOS_USE_APP_DEMOAPP
	bool "Demo app"
	default n
	help
		Select the app demo.

config XOS_USE_APP_DEMOLIST
	bool "Demo list"
	default n
	help
		Select the app demo list.

config XOS_USE_APP_DIGITAL_CLOCK
	bool "Digital Clock"
	default n
	help
		Select the app digital alock.

config XOS_USE_APP_FACE_RECOGNIZE
	bool "Face Recognize"
	default n
	help
		Select the app face recognize.

config XOS_USE_APP_LAUNCHER
	bool "Launcher"
	default n
	help
		Select the app launcher.

config XOS_USE_APP_LAUNCHER_RES_OVERLAY
	bool "Launcher res overlay"
	default n
	help
		Select the app launcher res overlay(launcher res in product/xxx).

config XOS_USE_APP_STATUS_BAR
	bool "Status bar"
	default n
	help
		Select the app status bar.

config XOS_USE_APP_LAYER_DEMO
	bool "Layer demo"
	default n
	help
		Select the app layer demo.

config XOS_USE_APP_HEALTH
	bool "Health"
	default n
	help
		Select the app health.

config XOS_USE_APP_VIDEO_CALL
	bool "Video call"
	default n
	help
		Select the app video call.

config XOS_USE_APP_PETROBOT
	bool "Petrobot"
	default n
	help
		Select the app petrobot.

config XOS_USE_APP_MOMO_TALK
	bool "MomoTalk"
	default n
	help 
		Select the app momotalk

config XOS_USE_APP_SMARTHOME_NEW
	bool "Smarthome"
	default n
	help 
		Select the app smarthome_new.
		
config XOS_USE_APP_SCANNER
	bool "Scanner"
	default n
	help
		Select the app scanner.

config XOS_USE_APP_GALLERY
	bool "Gallery"
	default n
	help
		Select the app gallery.

config XOS_USE_APP_SETTING
	bool "Setting"
	default n
	help
		Select the app setting.

config XOS_USE_APP_SMART_DOOR
	bool "Smart door"
	default n
	help
		Select the app smart door.

config XOS_USE_APP_QETV
	bool "Qetv"
	default n
	help
		Select the app qetv.

config XOS_USE_APP_H5_ESL
	bool "H5 ESLs"
	default n
	help
		Select the app H5 Electronic Shelf Label.

config XOS_USE_APP_MOTO
	bool "Moto DashBoard"
	default n
	help
		Select the app moto.

config XOS_USE_APP_MOTOT
	bool "Motot"
	default n
	help
		Select the app motot.

config XOS_USE_APP_MOTOX
	bool "Motox"
	default n
	help
		Select the app motox.

config XOS_USE_APP_MOTOX_RD
	bool "Motox_rd"
	default n
	help
		Select the app motox_rd.

config XOS_USE_APP_MOTOX102D
	bool "Motox102d"
	default n
	help
		Select the app motox102d.

config XOS_USE_APP_MOTOX7IN
	bool "Motox7in"
	default n
	help
		Select the app motox7in.

config XOS_USE_APP_SCANPEN
	bool "Scanpen"
	default n
	help
		Select the app scanpen.

config XOS_USE_APP_LOTTIEDEMO
	bool "Lottie"
	default n
	help
		Select the app lottie demo.

config XOS_USE_APP_SMARTHOME
	bool "Smart Home"
	default n
	help
		Select the app smart home.

config XOS_USE_APP_XHOME
	bool "Smart Home"
	default n
	help
		Select the app xhome.

config XOS_USE_APP_SPHOTO
	bool "Smart Photo"
	default n
	help
		Select the app smart photo.

config XOS_USE_APP_AIOBJ
	bool "Ai Obj"
	default n
	help
		Select the app AI OBJ.

config XOS_USE_APP_AICHAT
	bool "Ai Chat"
	default n
	help
		Select the app AI Chat.

config XOS_USE_APP_AIOCR
	bool "Ai Ocr"
	default n
	help
		Select the app AI OCR.

config XOS_USE_APP_PHOTO
	bool "Photo"
	default n
	help
		Select the app photo.

config XOS_USE_APP_VIDEO
	bool "Photo"
	default n
	help
		Select the app video.

config XOS_USE_APP_MORESETTING
	bool "Moresetting"
	default n
	help 
		Select the app moresetting

config XOS_LITE_MODE
	bool "Lite Mode"
	default n
	help
		Select the lite mode.

config XOS_DARK_MODE
	bool "Dark Mode"
	default n
	help
		Select the dark mode.

config XOS_USE_APP_FRAMEO
	bool "Frameo"
	default n
	help
		Select the app frameo.

config XOS_IMAGEVIEWER_ACC
	bool "iamgeACC"
	default n
	help
		Select the app image acc.

config XOS_USE_APP_NATIVE_ESL
	bool "native esl"
	default n
	help
		Select the app native esl.

config XOS_APP_ESL2
	bool "esl2"
	default n
	help
		Select the app native esl.

config XOS_USE_APP_NATIVE_SMARTDOOR
	bool "native smartdoor"
	default n
	help
		Select the app native smartdoor.

config XOS_APP_SETTING_PAD
	bool "Setting Pad"
	default n
	help
		Select the app setting pad.

config XOS_USE_APP_SETUPWIZARD
	bool "SetupWizard"
	default n
	help
		Select the app SetupWizard.

config XOS_USE_APP_WIFIX
	bool "Wifix"
	default n
	help
		Select the app wifix.

config XOS_APP_MEDIA_PLAYER
	bool "gallery mixed viewer"
	default n
	help
		Select gallery view mode.

config XOS_USE_PHOTO_FRAME
	bool "photo frame"
	default n
	help
		Select photo frame.

config XOS_USE_APP_SCREEN_PROTECT
    bool "screen protect"
    default n
	help
		Select photo frame.

config XOS_USE_APP_STUDYPILOT
    bool "studypilot protect"
    default n
	help
		Select studypilot.

config XOS_APP_GRID_STYLE
    bool "grid style"
    default n
    help
        Select grid style.

endmenu

endif # XOS_USE_NO_QUAUI
```

## build/kconf/Kconfig.base
```kconfig
# Include configuration if selected
#source "build/kconf/Kconfig.chipset"
source "build/kconf/Kconfig.sdk"
#source "build/kconf/Kconfig.os"
source "build/kconf/Kconfig.storage"
```

## build/kconf/Kconfig.chipset
```kconfig
#chipset select
#
menu "Chipset family "


choice
    prompt "Chipset family:"
    default CHIPSET_QM10XH

config CHIPSET_MC331X
    bool "mc331x family"
    help
      Configuration for mc331x chipset.

config CHIPSET_QM10XH
    bool "qm10xh family"
    help
      Configuration for qm10xh chipset.

config CHIPSET_QM10XV
    bool "qm10xv family"
    help
      Configuration for qm10xv chipset.

config CHIPSET_QM10XD
    bool "qm10xd family"
    help
      Configuration for qm10xd chipset.

config CHIPSET_SIMULATOR
    bool "simulator"
    help
      Configuration for simulator.

# add new chipset here
#TODO

endchoice

if CHIPSET_MC331X
config CHIPSET_mc3310
    bool "mc3310"
    default y
    depends on CHIPSET_MC331X
    help
      Configuration for mc3310 chipset.

config CHIPSET_mc3312
    bool "mc3312"
    default n
    depends on CHIPSET_MC331X
    help
      Configuration for mc3312 chipset.

# add new chipset here
#TODO
endif

if CHIPSET_QM10XH
config CHIPSET_QM108H
    bool "qm108h"
    default n
    depends on CHIPSET_QM10XH
    help
      Configuration for qm108h chipset.
      support 256MB DDR inside

config CHIPSET_QM107H
    bool "qm107h"
    default n
    depends on CHIPSET_QM10XH
    help
      Configuration for qm107h chipset.
      support 256MB DDR inside

# add new chipset here
#TODO
endif

if CHIPSET_QM10XV
config CHIPSET_QM101V
    bool "qm101v"
    default y
    depends on CHIPSET_QM10XV
    help
      Configuration for qm101v chipset.
      support 64MB DDR chipset inside

config CHIPSET_QM102V
    bool "qm102v"
    default n
    depends on CHIPSET_QM10XV
    help
      Configuration for qm102v chipset.
      support 64MB DDR chipset inside

# add new chipset here
#TODO
endif

if CHIPSET_QM10XD
config CHIPSET_QM102D
    bool "qm102d"
    default y
    depends on CHIPSET_QM10XD
    help
      Configuration for qm102d chipset.
      support 64M DDR inside

config CHIPSET_QM101D
    bool "qm101d"
    default n
    depends on CHIPSET_QM10XD
    help
      Configuration for qm101d chipset.
      support DDR inside

# add more chipset herer
endif


# Include more configuration here
endmenu
```

## build/kconf/Kconfig.core
```kconfig
#
# For a description of the syntax of this configuration file,
# see Documentation/kbuild/kconfig-language.txt.
#
#gsource "core/board/Kconfig"
#gsource "core/res/Kconfig"
source "build/kconf/Kconfig.apps"
## source code localed at 'core/package/'
source "build/kconf/Kconfig.pkg"
```

## build/kconf/Kconfig.example
```kconfig
# Kconfig - example configuration options

menu "Example Configuration"

config XOS_BUILD_EXAMPLE
	bool "build example code"
	default n
	help
	  Select this option if you want to print cmake debug info.
	  
config XOS_BUILD_EXAMPLE_AS_LIB
	bool "build example code as lib"
	default n
	depends on XOS_BUILD_EXAMPLE
	help
	  Select this option if you want to print cmake debug info.

config XOS_EXAMPLE_LIB_NAME
	string "sample lib name"
	default "hellosample"
	depends on XOS_BUILD_EXAMPLE_AS_LIB
	help
	  Select this option if you want to print cmake debug info.
	  
config XOS_BUILD_EXAMPLE_IFDEF
	bool "build example code as ifdef"
	default n
	depends on XOS_BUILD_EXAMPLE
	help
	  Select this option if you want to print cmake debug info.
	  
endmenu
```

## build/kconf/Kconfig.external
```kconfig
#
# For a description of the syntax of this configuration file,
# core/package/external configuration.
#

menu "External"

config XOS_EXT_CJSON
	bool "cjson"
	default y
	help
		Select the xos external cjson.

config XOS_EXT_CURL
	bool "curl"
	default n
	help
		Select the xos external curl.

config XOS_EXT_FDK_AAC
	bool "fdk_aacd"
	default n
	help
		Select the xos external fdk_aac.

config XOS_EXT_FFMPEG
	bool "ffmpeg"
	default n
	help
		Select the xos external ffmpeg.

config XOS_EXT_FREETYPE
	bool "Freetype"
	default n
	help
		Select the xos external freetype.

config XOS_EXT_GIFLIB
	bool "Giflib"
	default n
	help
		Select the xos external giflib.

config XOS_EXT_INIPARSER
	bool "Iniparser"
	default n
	help
		Select the xos external iniparser.

config XOS_EXT_LIBPNG
	bool "libpng"
	default n
	help
		Select the xos external libpng.

config XOS_EXT_BROWSER
	bool "Browser"
	default n
	help
		Select the xos external browser.

config XOS_EXT_LIVE
	bool "Live"
	default n
	help
		Select the xos external live.

config XOS_EXT_LVBINDJS
	bool "lv binding js"
	default n
	help
		Select the xos external lv_binding_js.

config XOS_EXT_MXML
	bool "mxml"
	default n
	help
		Select the xos external mxml.

config XOS_EXT_OPENCV
	bool "Opencv"
	default n
	help
		Select the xos external opencv.

config XOS_EXT_OPENSSL
	bool "Openssl"
	default n
	help
		Select the xos external openssl.

config XOS_EXT_RLOTTIE
	bool "rlottie"
	default n
	help
		Select the xos external rlottie.

config XOS_EXT_SPEN
	bool "spen"
	default n
	help
		Select the xos external spen.

config XOS_EXT_ZLIB
	bool "zlib"
	default n
	help
		Select the xos external zlib.

config XOS_EXT_QRCODE
	bool "Qrcode"
	default n
	help
		Select the xos external qrcode.

config XOS_EXT_HIREDIS
	bool "hiredis"
	default n
	help
		Select the xos external hiredis.

config XOS_EXT_JPEG
	bool "jpeg"
	default n
	help
		Select the xos external jpeg.

config XOS_EXT_FVAD
	bool "fvad"
	default n
	help
		Select the xos external fvad.

config XOS_EXT_SPNG
	bool "spng"
	default n
	help
		Select the xos external spng.

config XOS_EXT_SQLITE3
	bool "sqlite3"
	default n
	help
		Select the xos external sqlite3.

#add more external features here
#
endmenu
```
