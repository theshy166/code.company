/*
 * molchip
 *
 * Cortex-A7 MPCore
 *
 * HBI-0225B
 */

/dts-v1/;
#include "quaming-kernel-qm108h.dtsi"

/ {
	memory@40000000 {
		device_type = "memory";
		reg = <0x40000000 0x3000000>;
	};
	pmu_ram: pmuram@10000000 {
		compatible = "mol,pmu-ram";
		reg = <0x10000000 0x1000>;
	};

	pmu: power-reg@10100000 {
		compatible = "mol,pmu-reg";
		reg = <0x10100000 0x1000>;
	};
};

	
